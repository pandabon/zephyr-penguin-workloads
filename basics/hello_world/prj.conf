## CMakeLists.txt
```
# SPDX-License-Identifier: Apache-2.0

cmake_minimum_required(VERSION 3.20.0)

find_package(Zephyr REQUIRED HINTS $ENV{ZEPHYR_BASE})
project(penguin_basics_hello_world)

target_sources(app PRIVATE src/main.c)
```

## sample.yaml
```
# SPDX-License-Identifier: Apache-2.0
sample:
  name: penguin_basics_hello_world
common:
  platform_allow:
    - chipyard_penguin/penguin
    - chipyard_penguin/penguin/vcu118_ta
  tags: basics
tests:
  basics.hello_world:
    harness: console
    harness_config:
      type: one_line
      regex:
        - "Hello World! chipyard_penguin/penguin"
```

## prj.conf
```kconfig
# SPDX-License-Identifier: Apache-2.0
# Nothing to configure: one hart, defaults only. (The board's console and HTIF exit come from the board repo, zephyr-penguin.)
```

## src/main.c
```c
/*
 * Copyright (c) 2012-2014 Wind River Systems, Inc.
 *
 * SPDX-License-Identifier: Apache-2.0
 *
 * Credits: Zephyr's samples/hello_world (Wind River Systems, Apache-2.0), with the HTIF exit added
 * by Dima Nikiforov in ucb-bar/zephyr-chipyard-sw (branch dev @ 838a4fed2be, samples/hello_world).
 * Copied into penguin-workloads unchanged except for this comment.
 */

#include <stdio.h>
#include <zephyr/sys/reboot.h>

int main(void)
{
	// Print to the host via TSI
	printf("Hello World! %s\n", CONFIG_BOARD_TARGET);

	// Send an exit command to the host to terminate the simulation
	sys_reboot(SYS_REBOOT_COLD);
	return 0;
}
```
