## CMakeLists.txt
```
# SPDX-License-Identifier: Apache-2.0
#
# ExecuTorch (+ XNNPACK RVV kernels) MNIST runner for the Penguin SoC.
#
# OPT-IN: this app needs two external source trees that this repo does NOT contain:
#   EXECUTORCH_DIR  an ExecuTorch checkout (a directory named "executorch")
#   XNNPACK_DIR     an XNNPACK checkout (optional if EXECUTORCH_DIR already has a working
#                   backends/xnnpack/third-party/XNNPACK)
# plus `flatc` and a python3 with torchgen/pyyaml for ExecuTorch's codegen (PYTHON_EXECUTABLE,
# FLATC_EXECUTABLE or on PATH). Without them the configure step stops with an explanation.
# Unset variables default to the checkouts of the west group `executorch` (west.yml, off by
# default; PW-2): <west topdir>/modules/lib/executorch and <west topdir>/modules/lib/XNNPACK.
# Turn it on once with `west config manifest.group-filter -- +executorch` and `west update`.
# CMake downloads nothing, and nothing in the given trees is modified.
#
# Model: -DEXEC_MODEL=mnist_mlp_fp32 (default) | mnist_mlp_bf16 | lenet_bf16_user | /path/to/x.pte
#
# Credits: derived from samples/exeggutorch/executor_runner/CMakeLists.txt of
# pandabon/zephyr-chipyard-sw (branch exeggutorch @ e12bfa38034, Jonathan Lin), itself from
# ExecuTorch examples/arm/executor_runner (Copyright 2023-2024 Arm Limited and/or its
# affiliates; BSD-style license of the ExecuTorch repo).

cmake_minimum_required(VERSION 3.20)

# ---- opt-in dependencies, located by variable or environment -----------------
foreach(_v EXECUTORCH_DIR XNNPACK_DIR)
  if(NOT DEFINED ${_v} AND DEFINED ENV{${_v}})
    set(${_v} "$ENV{${_v}}")
  endif()
endforeach()

# Defaults: the west group `executorch` (west.yml). Only used when the checkout exists.
set(_west_lib "")
find_program(_west_exe west)
if(_west_exe)
  execute_process(COMMAND ${_west_exe} topdir OUTPUT_VARIABLE _west_topdir
                  OUTPUT_STRIP_TRAILING_WHITESPACE ERROR_QUIET RESULT_VARIABLE _west_rc)
  if(_west_rc EQUAL 0 AND _west_topdir)
    set(_west_lib "${_west_topdir}/modules/lib")
  endif()
endif()
if(NOT EXECUTORCH_DIR AND _west_lib AND EXISTS "${_west_lib}/executorch/CMakeLists.txt")
  set(EXECUTORCH_DIR "${_west_lib}/executorch")
endif()
if(NOT XNNPACK_DIR AND _west_lib AND EXISTS "${_west_lib}/XNNPACK/CMakeLists.txt")
  set(XNNPACK_DIR "${_west_lib}/XNNPACK")
endif()

set(_dep_help "\n  This app is an opt-in workload: ExecuTorch and XNNPACK are not part of this repo.\n  Either turn on the west group that fetches them at the tested commits (once per workspace):\n    west config manifest.group-filter -- +executorch && west update\n  or point at your own checkouts:\n    export EXECUTORCH_DIR=/path/to/executorch      # directory is named 'executorch'\n    export XNNPACK_DIR=/path/to/XNNPACK\n  and in both cases:\n    export PATH=/path/to/env/bin:$PATH             # flatc + python3 with torchgen, pyyaml\n  See the ExecuTorch section of the repo README.md.\n")
if(NOT EXECUTORCH_DIR OR NOT EXISTS "${EXECUTORCH_DIR}/CMakeLists.txt")
  message(FATAL_ERROR "ExecuTorch not found: EXECUTORCH_DIR is not set or has no CMakeLists.txt (got '${EXECUTORCH_DIR}'), and the west group checkout '${_west_lib}/executorch' is missing.${_dep_help}")
endif()
get_filename_component(EXECUTORCH_DIR "${EXECUTORCH_DIR}" REALPATH)
get_filename_component(_et_name "${EXECUTORCH_DIR}" NAME)
if(NOT _et_name STREQUAL "executorch")
  message(FATAL_ERROR "EXECUTORCH_DIR must be a directory named 'executorch' (its headers are included as <executorch/...> relative to its parent); got '${EXECUTORCH_DIR}'.")
endif()
if(XNNPACK_DIR)
  if(NOT EXISTS "${XNNPACK_DIR}/CMakeLists.txt")
    message(FATAL_ERROR "XNNPACK_DIR='${XNNPACK_DIR}' has no CMakeLists.txt.${_dep_help}")
  endif()
elseif(NOT EXISTS "${EXECUTORCH_DIR}/backends/xnnpack/third-party/XNNPACK/CMakeLists.txt")
  message(FATAL_ERROR "XNNPACK_DIR is not set and ${EXECUTORCH_DIR}/backends/xnnpack/third-party/XNNPACK is missing or a dangling link.${_dep_help}")
endif()

find_program(FLATC_EXECUTABLE flatc)
if(NOT FLATC_EXECUTABLE)
  message(FATAL_ERROR "flatc not found (pass -DFLATC_EXECUTABLE=... or put it on PATH).${_dep_help}")
endif()

# ---- model -------------------------------------------------------------------
set(EXEC_MODEL "mnist_mlp_fp32" CACHE STRING "Model: a name in models/ (without .pte) or a path to a .pte")
if(EXEC_MODEL MATCHES "\\.pte$")
  set(_pte "${EXEC_MODEL}")
else()
  set(_pte "${CMAKE_CURRENT_SOURCE_DIR}/models/${EXEC_MODEL}.pte")
endif()
if(NOT EXISTS "${_pte}")
  message(FATAL_ERROR "model '${_pte}' not found (EXEC_MODEL=${EXEC_MODEL}); regenerate with scripts/gen_model.py")
endif()
set_property(DIRECTORY APPEND PROPERTY CMAKE_CONFIGURE_DEPENDS "${_pte}")

# .pte -> C array in section network_model_sec (placed by custom-sections.ld), like exeggutorch's
# pte_to_header.py. Done at configure time with CMake only, so the build needs no extra python.
file(READ "${_pte}" _hex HEX)
string(LENGTH "${_hex}" _hexlen)
math(EXPR _pte_size "${_hexlen} / 2")
string(REGEX REPLACE "([0-9a-f][0-9a-f])" "0x\\1," _bytes "${_hex}")
file(WRITE "${CMAKE_CURRENT_BINARY_DIR}/model_pte.c"
  "/* generated from ${_pte} */\n"
  "__attribute__((section(\"network_model_sec\"), aligned(16))) unsigned char model_pte[] = {${_bytes}};\n"
  "unsigned int model_pte_size = ${_pte_size};\n")

# ---- ExecuTorch view: a symlink mirror in the build dir --------------------------
# Two reasons not to build straight from EXECUTORCH_DIR:
#  * its CMake looks for XNNPACK at backends/xnnpack/third-party/XNNPACK; the mirror lets
#    XNNPACK_DIR replace that one entry without touching EXECUTORCH_DIR;
#  * flatcc's CMake writes its libraries and a flatcc binary into its own source dir
#    (third-party/flatcc/{lib,bin}); in the mirror that directory is a real one, so
#    EXECUTORCH_DIR stays read-only.
# Everything else in the mirror is a symlink back to EXECUTORCH_DIR.
function(_mirror_dir SRC DST)  # ARGN: entries NOT to link
  file(MAKE_DIRECTORY "${DST}")
  file(GLOB _entries RELATIVE "${SRC}" "${SRC}/*" "${SRC}/.[A-Za-z]*")
  foreach(_e IN LISTS _entries)
    if(NOT _e IN_LIST ARGN)
      file(CREATE_LINK "${SRC}/${_e}" "${DST}/${_e}" SYMBOLIC)
    endif()
  endforeach()
endfunction()

set(_view "${CMAKE_CURRENT_BINARY_DIR}/et_view/executorch")
file(REMOVE_RECURSE "${CMAKE_CURRENT_BINARY_DIR}/et_view")
_mirror_dir("${EXECUTORCH_DIR}" "${_view}" backends third-party)
_mirror_dir("${EXECUTORCH_DIR}/backends" "${_view}/backends" xnnpack)
_mirror_dir("${EXECUTORCH_DIR}/backends/xnnpack" "${_view}/backends/xnnpack" third-party)
_mirror_dir("${EXECUTORCH_DIR}/backends/xnnpack/third-party" "${_view}/backends/xnnpack/third-party" XNNPACK)
if(XNNPACK_DIR)
  file(CREATE_LINK "${XNNPACK_DIR}" "${_view}/backends/xnnpack/third-party/XNNPACK" SYMBOLIC)
else()
  file(CREATE_LINK "${EXECUTORCH_DIR}/backends/xnnpack/third-party/XNNPACK" "${_view}/backends/xnnpack/third-party/XNNPACK" SYMBOLIC)
endif()
_mirror_dir("${EXECUTORCH_DIR}/third-party" "${_view}/third-party" flatcc)
# bin/ and lib/ are flatcc's build outputs: never link to them, even if a stale copy exists
_mirror_dir("${EXECUTORCH_DIR}/third-party/flatcc" "${_view}/third-party/flatcc" bin lib)
set(ET_DIR_PATH "${_view}")

set(ET_BUILD_DIR_PATH "${CMAKE_CURRENT_BINARY_DIR}/executorch" CACHE PATH "ExecuTorch build dir")
set(ET_INCLUDE_PATH "${ET_DIR_PATH}/.." CACHE PATH "ExecuTorch headers (parent of the executorch dir)")

add_compile_definitions(_POSIX_C_SOURCE=200809L __POSIX_VISIBLE=200809L)

find_package(Zephyr REQUIRED HINTS $ENV{ZEPHYR_BASE})
project(penguin_executorch_runner)
set(CMAKE_CXX_STANDARD 20)
set(CMAKE_EXPORT_COMPILE_COMMANDS ON)

set(EXECUTORCH_BUILD_EXECUTOR_RUNNER OFF CACHE BOOL "")
set(EXECUTORCH_BUILD_EXTENSION_RUNNER_UTIL ON CACHE BOOL "")
set(EXECUTORCH_BUILD_KERNELS_QUANTIZED OFF CACHE BOOL "")
set(EXECUTORCH_ENABLE_LOGGING ON CACHE BOOL "")
set(EXECUTORCH_BUILD_CPUINFO OFF CACHE BOOL "")
set(EXECUTORCH_BUILD_PTHREADPOOL OFF CACHE BOOL "")
set(EXECUTORCH_BUILD_GFLAGS OFF CACHE BOOL "")
set(EXECUTORCH_BUILD_HOST_TARGETS OFF CACHE BOOL "")

set(EXECUTORCH_BUILD_XNNPACK ON CACHE BOOL "")
set(XNNPACK_ENABLE_RISCV_GEMMINI OFF CACHE BOOL "Build XNNPACK with RISC-V Gemmini micro-kernels")
set(XNNPACK_ENABLE_RISCV_VECTOR ON CACHE BOOL "Build XNNPACK with RISC-V Vector micro-kernels")
# Zvfbfmin/Zvfbfa kernels are used for bf16 models; Penguin has both (D17), Spike needs them in
# its ISA string (the Penguin board adds zfbfmin/zvfbfa). Set OFF if your core lacks them.
set(XNNPACK_ENABLE_RISCV_ZVFBFMIN ON CACHE BOOL "Build XNNPACK with RISC-V Zvfbfmin micro-kernels")
set(XNNPACK_ENABLE_RISCV_ZVFBFA ON CACHE BOOL "Build XNNPACK with RISC-V Zvfbfa micro-kernels")
set(XNNPACK_BUILD_TESTS OFF CACHE BOOL "Build XNNPack unit tests")
set(XNNPACK_BUILD_BENCHMARKS OFF CACHE BOOL "Build XNNPack benchmarks")
set(FLATCC_RTONLY ON CACHE BOOL "enable build of runtime library of flatbuffers only")

add_subdirectory(${ET_DIR_PATH} ${ET_BUILD_DIR_PATH})

# ExecuTorch's third-party libs are built with the app's Zephyr include/flag set.
add_library(compile_commands INTERFACE)
target_include_directories(compile_commands INTERFACE $<TARGET_PROPERTY:app,INTERFACE_INCLUDE_DIRECTORIES>)
target_compile_options(compile_commands INTERFACE $<TARGET_PROPERTY:app,INTERFACE_COMPILE_OPTIONS>)
target_compile_definitions(compile_commands INTERFACE $<TARGET_PROPERTY:app,INTERFACE_COMPILE_DEFINITIONS>)
add_dependencies(compile_commands zephyr_interface)
add_dependencies(compile_commands zephyr_property_target)
target_link_libraries(pthreadpool PUBLIC compile_commands)

target_link_libraries(app PRIVATE
  extension_runner_util executorch executorch_core portable_ops_lib portable_kernels
  xnnpack_backend XNNPACK xnnpack-microkernels-prod extension_threadpool
)

target_include_directories(app PRIVATE ${ET_INCLUDE_PATH} ${CMAKE_CURRENT_BINARY_DIR} ${CMAKE_CURRENT_SOURCE_DIR}/src)
target_sources(app PRIVATE src/riscv_executor_runner.cpp ${CMAKE_CURRENT_BINARY_DIR}/model_pte.c)
zephyr_linker_sources(DATA_SECTIONS custom-sections.ld)
```

## sample.yaml
```
# SPDX-License-Identifier: Apache-2.0
# ExecuTorch workloads are OPT-IN: they need the west group `executorch` turned on (or EXECUTORCH_DIR,
# and usually XNNPACK_DIR, set), plus flatc/python on PATH, or CMake stops at configure. Twister has no "skip unless env var" key,
# so the tests carry the tag `executorch`: leave them out of a normal run with
#   twister -e executorch ...
# and select them with `--tag executorch` after exporting the variables (see the ExecuTorch section of the repo README.md).
# For the board repo's (zephyr-penguin) scripts/run_tests.py (--root), each test also carries `skip: true` so a normal suite run reports
# them as SKIP instead of failing at configure; build them directly (README) once the variables are set.
# They are build-only; the Spike run is `west build -t run` (expected output in the repo README.md).
sample:
  name: penguin_executorch_mnist
  description: ExecuTorch MNIST MLP (XNNPACK RVV kernels) on the Penguin SoC
common:
  build_only: true
  tags: executorch workload rvv
  platform_allow:
    - chipyard_penguin/penguin
    - chipyard_penguin/penguin/vcu118_ta
  harness: console
  harness_config:
    type: multi_line
    regex:
      - "Model executed successfully"
      - "Output\\[0\\]\\[0\\]:"
tests:
  workload.executorch.mnist_fp32:
    extra_args: EXEC_MODEL=mnist_mlp_fp32
    skip: true
  workload.executorch.mnist_bf16:
    extra_args: EXEC_MODEL=mnist_mlp_bf16
    skip: true
  workload.executorch.lenet_bf16_user:
    extra_args: EXEC_MODEL=lenet_bf16_user
    skip: true
```

## prj.conf
```kconfig
# SPDX-License-Identifier: Apache-2.0
# Kconfig for the ExecuTorch runner. Derived from samples/exeggutorch/executor_runner/prj.conf of
# pandabon/zephyr-chipyard-sw (branch exeggutorch @ e12bfa38034, Jonathan Lin), with the sizes
# the 2026-10-09 bench build used (1 MiB heap, 1 MiB malloc arena).

# One hart; the SMP scheduler options are what ExecuTorch's threadpool build needs.
CONFIG_THREAD_STACK_INFO=y
CONFIG_MP_MAX_NUM_CPUS=1
CONFIG_SMP=y
CONFIG_MAIN_STACK_SIZE=16384
CONFIG_THREAD_STACK_MEM_MAPPED=y
CONFIG_DYNAMIC_THREAD=y
CONFIG_DYNAMIC_THREAD_STACK_SIZE=16384
CONFIG_DYNAMIC_THREAD_ALLOC=y
CONFIG_SCHED_CPU_MASK=y
CONFIG_SCHED_CPU_MASK_PIN_ONLY=y
CONFIG_SCHED_DUMB=y

CONFIG_POSIX_API=y
CONFIG_MULTITHREADING=y
CONFIG_POSIX_THREADS=y

CONFIG_FPU=y
CONFIG_RISCV_ISA_EXT_V=y

# Memory: the image is ~12 MB of XNNPACK kernels + these two arenas (zero-filled .bss/noinit).
# Shrinking them shortens the UART load (see the ExecuTorch section of the repo README: load time = memsz).
CONFIG_HEAP_MEM_POOL_SIZE=1048576
CONFIG_COMMON_LIBC_MALLOC=y
CONFIG_COMMON_LIBC_MALLOC_ARENA_SIZE=1048576

CONFIG_CPP=y
CONFIG_STD_C17=y
CONFIG_STD_CPP20=y
CONFIG_GLIBCXX_LIBCPP=y
CONFIG_PICOLIBC=y
```

## src/riscv_executor_runner.cpp
```c
/*
 * ExecuTorch runner for the Penguin SoC (Zephyr, HTIF/UART console).
 *
 * Credits:
 *  - Derived from ExecuTorch's examples/arm/executor_runner/arm_executor_runner.cpp
 *    (Copyright (c) Meta Platforms, Inc. and affiliates; Copyright 2023-2024 Arm Limited
 *    and/or its affiliates; BSD-style license, see the LICENSE file in the ExecuTorch root).
 *  - Ported to RISC-V/Zephyr by Jonathan Lin (UC Berkeley), repo pandabon/zephyr-chipyard-sw,
 *    branch exeggutorch @ e12bfa38034, samples/exeggutorch/executor_runner/riscv_executor_runner.cpp
 *    (bf16 output printing, input fill, memory statistics).
 *  - Heap fix (empty BufferCleanup) and clean exit code: found while building the 2026-10-09
 *    bench ELFs; the same BufferCleanup change is in the author's working tree of the repo above.
 *
 * Changes versus the exeggutorch version:
 *  - method_allocation_pool_size is a compile definition (ET_METHOD_POOL_SIZE, default 64 KiB;
 *    the MNIST MLP needs ~7 KB. The pool is a static array, so it is part of the loaded image).
 *  - main() ends with chipyard_sim_exit(rc): rc 0 only after "Model executed successfully",
 *    so the host (uart_tsi / Spike) sees PASS/FAIL instead of a fault after main() returns.
 */

#include <errno.h>
#include <memory>
#include <stdio.h>
#include <unistd.h>
#include <vector>

#include <executorch/extension/data_loader/buffer_data_loader.h>
#include <executorch/extension/runner_util/inputs.h>
#include <executorch/runtime/core/memory_allocator.h>
#include <executorch/runtime/executor/program.h>
#include <executorch/runtime/platform/log.h>
#include <executorch/runtime/platform/platform.h>
#include <executorch/runtime/platform/runtime.h>

struct _reent * _impure_ptr = nullptr;

void *__dso_handle = nullptr;

extern "C" {
#include <chipyard/sim_exit.h>
}
#include "model_pte.h"

using executorch::aten::ScalarType;
using executorch::aten::Tensor;
using executorch::aten::TensorImpl;
using executorch::extension::BufferCleanup;
using executorch::extension::BufferDataLoader;
using executorch::runtime::Error;
using executorch::runtime::EValue;
using executorch::runtime::HierarchicalAllocator;
using executorch::runtime::MemoryAllocator;
using executorch::runtime::MemoryManager;
using executorch::runtime::Method;
using executorch::runtime::MethodMeta;
using executorch::runtime::Program;
using executorch::runtime::Result;
using executorch::runtime::Span;
using executorch::runtime::Tag;
using executorch::runtime::TensorInfo;

/**
 * The method_allocation_pool should be large enough to fit the setup, input
 * used and other data used like the planned memory pool (e.g. memory-planned
 * buffers to use for mutable tensor data).
 */
// const size_t method_allocation_pool_size = 20 * 1024 * 1024;
#ifndef ET_METHOD_POOL_SIZE
#define ET_METHOD_POOL_SIZE (64 * 1024)
#endif
const size_t method_allocation_pool_size = ET_METHOD_POOL_SIZE;
unsigned char
	__attribute__((section("input_data_sec"), aligned(16))) method_allocation_pool[method_allocation_pool_size];

/**
 * The temp_allocation_pool is used for allocating temporary data during kernel
 * or delegate execution. This will be reset after each kernel or delegate call.
 * Currently a MemoryAllocator is used but a PlatformMemoryAllocator is probably
 * a better fit
 */
// const size_t temp_allocation_pool_size = 1 * 1024 * 1024;
const size_t temp_allocation_pool_size = 1024;
unsigned char __attribute__((section("input_data_sec"), aligned(16))) temp_allocation_pool[temp_allocation_pool_size];

/* void et_pal_init(void)
{
} */

ET_NORETURN void et_pal_abort(void)
{
#ifndef SEMIHOSTING
	__builtin_trap();
#else
	_exit(-1);
#endif
}

/**
 * Emit a log message via platform output (serial port, console, etc).
 */
void et_pal_emit_log_message(ET_UNUSED et_timestamp_t timestamp, et_pal_log_level_t level, const char *filename,
							 ET_UNUSED const char *function, size_t line, const char *message, ET_UNUSED size_t length)
{
	fprintf(stderr, "%c [executorch:%s:%zu] %s\n", level, filename, line, message);
}

namespace
{

// Setup our own allocator that can show some extra stuff like used and free memory info
class RiscvMemoryAllocator : public executorch::runtime::MemoryAllocator
{
public:
	RiscvMemoryAllocator(uint32_t size, uint8_t *base_address) : MemoryAllocator(size, base_address), used_(0)
	{
	}

	void *allocate(size_t size, size_t alignment = kDefaultAlignment) override
	{
		void *ret = executorch::runtime::MemoryAllocator::allocate(size, alignment);
		if (ret != nullptr)
		{
			// Align with the same code as in MemoryAllocator::allocate() to keep
			// used_ "in sync" As alignment is expected to be power of 2 (checked by
			// MemoryAllocator::allocate()) we can check it the lower bits
			// (same as alignment - 1) is zero or not.
			if ((size & (alignment - 1)) == 0)
			{
				// Already aligned.
				used_ += size;
			}
			else
			{
				used_ = (used_ | (alignment - 1)) + 1 + size;
			}
		}
		return ret;
	}

	// Returns the used size of the allocator's memory buffer.
	size_t used_size() const
	{
		return used_;
	}

	// Returns the free size of the allocator's memory buffer.
	size_t free_size() const
	{
		return executorch::runtime::MemoryAllocator::size() - used_;
	}

private:
	size_t used_;
};

Result<BufferCleanup> prepare_input_tensors(Method &method, MemoryAllocator &allocator,
											std::vector<std::pair<char *, size_t>> &input_buffers)
{
	MethodMeta method_meta = method.method_meta();
	size_t num_inputs = method_meta.num_inputs();
	size_t num_allocated = 0;

	void **inputs = static_cast<void **>(allocator.allocate(num_inputs * sizeof(void *)));

	ET_CHECK_OR_RETURN_ERROR(inputs != nullptr, MemoryAllocationFailed,
							 "Could not allocate memory for pointers to input buffers.");

	for (size_t i = 0; i < num_inputs; i++)
	{
		auto tag = method_meta.input_tag(i);
		ET_CHECK_OK_OR_RETURN_ERROR(tag.error());

		if (tag.get() != Tag::Tensor)
		{
			ET_LOG(Debug, "Skipping non-tensor input %zu", i);
			continue;
		}
		Result<TensorInfo> tensor_meta = method_meta.input_tensor_meta(i);
		ET_CHECK_OK_OR_RETURN_ERROR(tensor_meta.error());

		// Input is a tensor. Allocate a buffer for it.
		void *data_ptr = allocator.allocate(tensor_meta->nbytes());
		ET_CHECK_OR_RETURN_ERROR(data_ptr != nullptr, MemoryAllocationFailed,
								 "Could not allocate memory for input buffers.");
		inputs[num_allocated++] = data_ptr;

		Error err = Error::Ok;
		if (input_buffers.size() > 0)
		{
			auto [buffer, buffer_size] = input_buffers.at(i);
			if (buffer_size != tensor_meta->nbytes())
			{
				ET_LOG(Error, "input size (%d) and tensor size (%d) missmatch!", buffer_size, tensor_meta->nbytes());
				err = Error::InvalidArgument;
			}
			else
			{
				ET_LOG(Info, "Copying read input to tensor.");
				std::memcpy(data_ptr, buffer, buffer_size);
			}
		}

		TensorImpl impl = TensorImpl(tensor_meta.get().scalar_type(), tensor_meta.get().sizes().size(),
									 const_cast<TensorImpl::SizesType *>(tensor_meta.get().sizes().data()), data_ptr,
									 const_cast<TensorImpl::DimOrderType *>(tensor_meta.get().dim_order().data()));
		Tensor t(&impl);

		// If input_buffers.size <= 0, we don't have any input, fill t with 1's.
		if (input_buffers.size() <= 0)
		{
			for (size_t j = 0; j < t.numel(); j++)
			{
				switch (t.scalar_type())
				{
				case ScalarType::Int:
					t.mutable_data_ptr<int>()[j] = 1;
					break;
				case ScalarType::Float:
					t.mutable_data_ptr<float>()[j] = 1.;
					break;
				case ScalarType::BFloat16:
				{
					// bf16 1.0 = 0x3F80
					reinterpret_cast<uint16_t*>(data_ptr)[j] = 0x3F80u;
					break;
				}
				default:
					break;
				}
			}
		}

		err = method.set_input(t, i);

		if (err != Error::Ok)
		{
			ET_LOG(Error, "Failed to prepare input %zu: 0x%" PRIx32, i, (uint32_t)err);
			// The inputs live in the static method pool (allocator above), not
			// on the heap, so there is nothing to free(): an empty span keeps
			// ~BufferCleanup from calling free() on pool addresses.
			BufferCleanup cleanup{executorch::runtime::Span<void *>()};
			return err;
		}
	}
	// Same reason: returning BufferCleanup({inputs, num_allocated}) made its
	// destructor free() pool memory when main() returned, corrupting the
	// Zephyr sys_heap (fault in set_chunk_used after "Program complete").
	return BufferCleanup(executorch::runtime::Span<void *>());
}

} // namespace

static int g_rc = 1; // 0 only after "Model executed successfully"
int main()
{
	executorch::runtime::runtime_init();
	std::vector<std::pair<char *, size_t>> input_buffers;
	size_t pte_size = model_pte_size;

	ET_LOG(Info, "Model in %p %c", model_pte, model_pte[0]);
	auto loader = BufferDataLoader(model_pte, pte_size);
	ET_LOG(Info, "Model PTE file loaded. Size: %lu bytes.", pte_size);
	Result<Program> program = Program::load(&loader);
	if (!program.ok())
	{
		ET_LOG(Info, "Program loading failed @ 0x%p: 0x%" PRIx32, model_pte, program.error());
	}

	ET_LOG(Info, "Model buffer loaded, has %lu methods", program->num_methods());

	const char *method_name = nullptr;
	{
		const auto method_name_result = program->get_method_name(0);
		ET_CHECK_MSG(method_name_result.ok(), "Program has no methods");
		method_name = *method_name_result;
	}
	ET_LOG(Info, "Running method %s", method_name);

	Result<MethodMeta> method_meta = program->method_meta(method_name);
	if (!method_meta.ok())
	{
		ET_LOG(Info, "Failed to get method_meta for %s: 0x%x", method_name, (unsigned int)method_meta.error());
	}

	ET_LOG(Info, "Setup Method allocator pool. Size: %lu bytes.", method_allocation_pool_size);

	RiscvMemoryAllocator method_allocator(method_allocation_pool_size, method_allocation_pool);

	std::vector<uint8_t *> planned_buffers;	  // Owns the memory
	std::vector<Span<uint8_t>> planned_spans; // Passed to the allocator
	size_t num_memory_planned_buffers = method_meta->num_memory_planned_buffers();

	size_t planned_buffer_membase = method_allocator.used_size();

	for (size_t id = 0; id < num_memory_planned_buffers; ++id)
	{
		size_t buffer_size = static_cast<size_t>(method_meta->memory_planned_buffer_size(id).get());
		ET_LOG(Info, "Setting up planned buffer %zu, size %zu.", id, buffer_size);

		/* Move to it's own allocator when MemoryPlanner is in place. */
		uint8_t *buffer = reinterpret_cast<uint8_t *>(method_allocator.allocate(buffer_size));
		planned_buffers.push_back(buffer);
		planned_spans.push_back({planned_buffers.back(), buffer_size});
	}

	size_t planned_buffer_memsize = method_allocator.used_size() - planned_buffer_membase;

	HierarchicalAllocator planned_memory({planned_spans.data(), planned_spans.size()});

	RiscvMemoryAllocator temp_allocator(temp_allocation_pool_size, temp_allocation_pool);

	MemoryManager memory_manager(&method_allocator, &planned_memory, &temp_allocator);

	size_t method_loaded_membase = method_allocator.used_size();

	Result<Method> method = program->load_method(method_name, &memory_manager);
	if (!method.ok())
	{
		ET_LOG(Info, "Loading of method %s failed with status 0x%" PRIx32, method_name, method.error());
	}
	size_t method_loaded_memsize = method_allocator.used_size() - method_loaded_membase;
	ET_LOG(Info, "Method loaded.");

	ET_LOG(Info, "Preparing inputs...");
	size_t input_membase = method_allocator.used_size();

	auto inputs = ::prepare_input_tensors(*method, method_allocator, input_buffers);

	if (!inputs.ok())
	{
		ET_LOG(Info, "Preparing inputs tensors for method %s failed with status 0x%" PRIx32, method_name,
			   inputs.error());
	}
	size_t input_memsize = method_allocator.used_size() - input_membase;
	ET_LOG(Info, "Input prepared.");

	ET_LOG(Info, "Starting the model execution...");
	size_t executor_membase = method_allocator.used_size();
	// StartMeasurements();
	Error status = method->execute();
	// StopMeasurements();
	size_t executor_memsize = method_allocator.used_size() - executor_membase;

	ET_LOG(Info, "model_pte_loaded_size:     %lu bytes.", pte_size);

	if (method_allocator.size() != 0)
	{
		size_t method_allocator_used = method_allocator.used_size();
		ET_LOG(Info, "method_allocator_used:     %zu / %zu  free: %zu ( used: %zu %% ) ", method_allocator_used,
			   method_allocator.size(), method_allocator.free_size(),
			   100 * method_allocator_used / method_allocator.size());
		ET_LOG(Info, "method_allocator_planned:  %zu bytes", planned_buffer_memsize);
		ET_LOG(Info, "method_allocator_loaded:   %zu bytes", method_loaded_memsize);
		ET_LOG(Info, "method_allocator_input:    %zu bytes", input_memsize);
		ET_LOG(Info, "method_allocator_executor: %zu bytes", executor_memsize);
	}
	if (temp_allocator.size() > 0)
	{
		ET_LOG(Info, "temp_allocator_used:       %zu / %zu free: %zu ( used: %zu %% ) ", temp_allocator.used_size(),
			   temp_allocator.size(), temp_allocator.free_size(),
			   100 * temp_allocator.used_size() / temp_allocator.size());
	}

	if (status != Error::Ok)
	{
		ET_LOG(Info, "Execution of method %s failed with status 0x%" PRIx32, method_name, status);
	}
	else
	{
		ET_LOG(Info, "Model executed successfully.");
		g_rc = 0;
	}

	std::vector<EValue> outputs(method->outputs_size());
	ET_LOG(Info, "%zu outputs: ", outputs.size());
	status = method->get_outputs(outputs.data(), outputs.size());
	ET_CHECK(status == Error::Ok);
	for (int i = 0; i < outputs.size(); ++i)
	{
		Tensor t = outputs[i].toTensor();
		// The output might be collected and parsed so printf() is used instead
		// of ET_LOG() here
		for (int j = 0; j < outputs[i].toTensor().numel(); ++j)
		{
			if (t.scalar_type() == ScalarType::Int)
			{
				printf("Output[%d][%d]: %d\n", i, j, outputs[i].toTensor().const_data_ptr<int>()[j]);
			}
			else if (t.scalar_type() == ScalarType::BFloat16)
			{
				// bf16 -> fp32: shift left 16 bits
				uint16_t raw = reinterpret_cast<const uint16_t*>(t.const_data_ptr())[j];
				uint32_t bits = (uint32_t)raw << 16;
				float val;
				std::memcpy(&val, &bits, sizeof(float));
				printf("Output[%d][%d]: %f\n", i, j, val);
			}
			else
			{
				printf("Output[%d][%d]: %f\n", i, j, outputs[i].toTensor().const_data_ptr<float>()[j]);
			}
		}
	}
out:
	ET_LOG(Info, "Program complete, exiting.");
	ET_LOG(Info, "\04");
	chipyard_sim_exit(g_rc);
}
```
