## CMakeLists.txt
```
# SPDX-License-Identifier: Apache-2.0
#
# One of XNNPACK's OWN, UNMODIFIED upstream GoogleTest files, run as a Zephyr application (on Spike or
# the chip). Pilot: everything runs on Zephyr, no bare-metal runtime.
#
# What is compiled, all straight from the dependency trees (nothing is copied or patched):
#   * the test file   XNNPACK_DIR/test/${XNN_TEST}.cc     (default f32-bf16-vcvt; any test/<name>.cc whose
#                     support sources are in XNN_TEST_SUPPORT works the same way)
#   * its support     XNNPACK_DIR/test/{unary-ops}.cc (add others, e.g. next_prime, as a test needs them)   (XNN_TEST_SUPPORT)
#   * XNNPACK         add_subdirectory(XNNPACK_DIR) with tests/benchmarks off, all micro-kernels on
#   * GoogleTest      EXECUTORCH_DIR/third-party/googletest (ExecuTorch's pinned submodule; nothing is downloaded)
#   * pthreadpool, FXdiv, cpuinfo   EXECUTORCH_DIR/backends/xnnpack/third-party/* (the versions ExecuTorch pins)
# The only code of ours is src/main.cpp: a main() that runs GoogleTest and exits through the BSP.
#
# OPT-IN: needs two external trees that this repo does NOT contain:
#   XNNPACK_DIR     an XNNPACK checkout (the test file is read from its test/ directory)
#   EXECUTORCH_DIR  an ExecuTorch checkout with third-party/googletest initialised
#                   (git submodule update --init --depth 1 third-party/googletest)
# or GOOGLETEST_DIR / THIRD_PARTY_DIR to point at the individual pieces. No flatc, no python torchgen.
# Nothing is downloaded and nothing in the given trees is modified.
#
# Options (-D...): XNN_TEST=f32-bf16-vcvt   which test/<name>.cc
#                  XNN_TEST_SUPPORT="unary-ops"  test-support sources (test/<name>.cc)
#                  XNN_TEST_FILTER=""       GoogleTest filter compiled in (default: run everything)
#                  XNN_TEST_SEED=""         GoogleTest random seed compiled in (default: its own time-based one)
#
# Credits:
#  * The idea of running XNNPACK's gtests on Spike comes from Jonathan Lin's archived harness
#    (pandabon/XNNPACK, branch torch-1.0.0-bump-bf16, docs-ucb-bar/spike-runtime.md @ 6c25b9e9e8); no code was taken from it (it was bare-metal).
#  * The Zephyr flag propagation to third-party targets and the generated-header ordering
#    are derived from executorch/smolvla in this repo, itself derived from samples/exeggutorch of
#    pandabon/zephyr-chipyard-sw (branch exeggutorch @ e12bfa38034, Jonathan Lin) and ExecuTorch
#    examples/arm/executor_runner (Copyright 2023-2024 Arm Limited and/or its affiliates; BSD-style license).
#  * The test files are Copyright Google LLC (and Facebook, Inc.), BSD-style license of the XNNPACK repo.

cmake_minimum_required(VERSION 3.20)

# Dependency lookup and the XNN_TEST* options are shared with the bare-metal mode.
include(${CMAKE_CURRENT_LIST_DIR}/cmake/xnnpack-tests-common.cmake)

add_compile_definitions(_POSIX_C_SOURCE=200809L __POSIX_VISIBLE=200809L)
# XNNPACK: no mmap/mprotect on Zephyr; cpuinfo's log.c wants STDERR_FILENO, which Zephyr's <unistd.h> lacks.
add_compile_definitions(XNN_HAS_MMAP=0 STDERR_FILENO=2)

find_package(Zephyr REQUIRED HINTS $ENV{ZEPHYR_BASE})
project(penguin_xnnpack_tests)
set(CMAKE_CXX_STANDARD 20)
set(CMAKE_EXPORT_COMPILE_COMMANDS ON)

# ---- XNNPACK and its dependencies, built as a normal CMake sub-project ----------
# XNNPACK/pthreadpool/cpuinfo options: see cmake/xnnpack-tests-common.cmake
add_subdirectory("${FXDIV_SOURCE_DIR}" fxdiv)

# Zephyr hands its include paths, definitions and ISA options (-march/-mabi/-mcmodel) to its own
# targets (zephyr_interface/app), not to CMAKE_<LANG>_FLAGS. The third-party libraries below are separate
# targets, so without this they are built for the compiler's default RISC-V target and against the SDK's
# default libc headers. So give every target created below the app's flag set.
include_directories($<TARGET_PROPERTY:app,INTERFACE_INCLUDE_DIRECTORIES>)
add_compile_options($<TARGET_PROPERTY:app,INTERFACE_COMPILE_OPTIONS>)
add_compile_definitions($<TARGET_PROPERTY:app,INTERFACE_COMPILE_DEFINITIONS>)

set(_xnn_build "${CMAKE_CURRENT_BINARY_DIR}/xnnpack")
add_subdirectory("${XNNPACK_DIR}" "${_xnn_build}" EXCLUDE_FROM_ALL)

# GoogleTest: no pthreads (Zephyr's POSIX layer is partial), no gmock, nothing installed.
set(gtest_disable_pthreads ON CACHE BOOL "")
set(BUILD_GMOCK OFF CACHE BOOL "")
set(INSTALL_GTEST OFF CACHE BOOL "")
set(gtest_build_tests OFF CACHE BOOL "")
add_subdirectory("${GOOGLETEST_DIR}" "${CMAKE_CURRENT_BINARY_DIR}/googletest" EXCLUDE_FROM_ALL)

# Zephyr's <unistd.h> lacks isatty/chdir/getcwd/dup/dup2 (see the header), and its POSIX limits clash
# with picolibc's under gtest's -Werror: shim the first, keep the second a warning (third-party code).
set(_gtest_shim "${CMAKE_CURRENT_SOURCE_DIR}/src/zephyr_compat/gtest_posix_shim.h")
target_compile_options(gtest PRIVATE $<$<COMPILE_LANGUAGE:CXX>:-include${_gtest_shim}> -Wno-error -w)

# Every library created above must wait for Zephyr's generated headers (zephyr/syscall_list.h,
# autoconf.h), or a parallel build can compile them before those exist.
function(_depend_on_zephyr_headers DIR)
  get_property(_targets DIRECTORY "${DIR}" PROPERTY BUILDSYSTEM_TARGETS)
  foreach(_t IN LISTS _targets)
    get_target_property(_type ${_t} TYPE)
    if(_type MATCHES "^(STATIC_LIBRARY|OBJECT_LIBRARY)$")
      add_dependencies(${_t} zephyr_generated_headers)
    endif()
  endforeach()
  get_property(_subdirs DIRECTORY "${DIR}" PROPERTY SUBDIRECTORIES)
  foreach(_d IN LISTS _subdirs)
    _depend_on_zephyr_headers("${_d}")
  endforeach()
endfunction()
_depend_on_zephyr_headers("${_xnn_build}")
_depend_on_zephyr_headers("${CMAKE_CURRENT_BINARY_DIR}/googletest")
_depend_on_zephyr_headers("${CMAKE_CURRENT_BINARY_DIR}/fxdiv")

# ---- the test application --------------------------------------------------------
# XNNPACK sets its configuration macros (XNN_ENABLE_RISCV_VECTOR, XNN_ENABLE_*...) with
# ADD_COMPILE_DEFINITIONS in its own directory; the test must see the same values (the .inc file
# lists the RVV kernels under XNN_ENABLE_RISCV_VECTOR), so take them from its directory property.
get_directory_property(_xnn_defs DIRECTORY "${XNNPACK_DIR}" COMPILE_DEFINITIONS)
set(_support)
foreach(_s IN LISTS XNN_TEST_SUPPORT)
  list(APPEND _support "${XNNPACK_DIR}/test/${_s}.cc")
endforeach()
target_sources(app PRIVATE src/main.cpp "${_test_src}" ${_support})
target_compile_definitions(app PRIVATE ${_xnn_defs} XNN_TEST_NAME="${XNN_TEST}" XNN_TEST_FILTER="${XNN_TEST_FILTER}" XNN_TEST_SEED="${XNN_TEST_SEED}")
# XNNPACK's headers are included as "src/xnnpack/..", "include/xnnpack.h", "test/..": the tree root is the include dir.
target_include_directories(app PRIVATE "${XNNPACK_DIR}" "${XNNPACK_DIR}/include" "${GOOGLETEST_DIR}/googletest/include")
target_compile_options(app PRIVATE $<$<COMPILE_LANGUAGE:CXX>:-include${_gtest_shim}>)
target_link_libraries(app PRIVATE
  gtest
  xnnpack-datatype xnnpack-hardware-config xnnpack-logging xnnpack-microkernels-all xnnpack-microparams-init
  # reference weight packers (src/reference/packing.cc): GEMM/conv microkernel testers pack weights with them
  xnnpack-packing
  pthreadpool
  ${XNN_TEST_LINK}
)
zephyr_linker_sources(DATA_SECTIONS custom-sections.ld)
```

## sample.yaml
```
# SPDX-License-Identifier: Apache-2.0
# XNNPACK's own gtest files are OPT-IN workloads: they need XNNPACK_DIR and EXECUTORCH_DIR (googletest
# + pthreadpool sources) set, or CMake stops at configure. Like the ExecuTorch apps, the tests carry the
# tag `xnnpack-tests` (leave them out of a normal twister run with `twister -e xnnpack-tests`) and
# `skip: true`, so the BSP's run_tests.py reports SKIP instead of failing at configure.
# Build-only: the Spike run is `west build -t run`. One scenario per upstream test file
# (copy others' tests faithfully, one upstream test = one scenario).
sample:
  name: penguin_xnnpack_tests
  description: One unmodified XNNPACK upstream gtest file as a Zephyr app
common:
  build_only: true
  tags: xnnpack-tests workload rvv
  platform_allow:
    - chipyard_penguin/penguin
  harness: console
  harness_config:
    type: multi_line
    regex:
      - "\\[  PASSED  \\] "
      - "ALL TESTS PASSED"
tests:
  workload.xnnpack_tests.f32_bf16_vcvt:
    extra_args: XNN_TEST=f32-bf16-vcvt
    skip: true
```

## prj.conf
```kconfig
# SPDX-License-Identifier: Apache-2.0
# Kconfig for the XNNPACK gtest app (copied from executorch/smolvla in this repo). Derived from samples/exeggutorch/executor_runner/prj.conf of
# pandabon/zephyr-chipyard-sw (branch exeggutorch @ e12bfa38034, Jonathan Lin), with the sizes
# the 2026-10-09 bench build used (1 MiB heap, 1 MiB malloc arena).

# One hart; the SMP scheduler options are what ExecuTorch's threadpool build needs.
CONFIG_THREAD_STACK_INFO=y
CONFIG_MP_MAX_NUM_CPUS=1
CONFIG_SMP=y
CONFIG_MAIN_STACK_SIZE=16384
CONFIG_THREAD_STACK_MEM_MAPPED=y
CONFIG_DYNAMIC_THREAD=y
CONFIG_DYNAMIC_THREAD_STACK_SIZE=16384
CONFIG_DYNAMIC_THREAD_ALLOC=y
CONFIG_SCHED_CPU_MASK=y
CONFIG_SCHED_CPU_MASK_PIN_ONLY=y
CONFIG_SCHED_DUMB=y

CONFIG_POSIX_API=y
CONFIG_MULTITHREADING=y
CONFIG_POSIX_THREADS=y

CONFIG_FPU=y
CONFIG_RISCV_ISA_EXT_V=y

# Memory: the image is ~12 MB of XNNPACK kernels + these two arenas (zero-filled .bss/noinit).
# Shrinking them shortens the UART load (see the ExecuTorch section of the repo README: load time = memsz).
CONFIG_HEAP_MEM_POOL_SIZE=1048576
CONFIG_COMMON_LIBC_MALLOC=y
CONFIG_COMMON_LIBC_MALLOC_ARENA_SIZE=1048576

CONFIG_CPP=y
CONFIG_STD_C17=y
CONFIG_STD_CPP20=y
CONFIG_GLIBCXX_LIBCPP=y
CONFIG_PICOLIBC=y

# XNNPACK and ExecuTorch create several mutexes (xnn_mutex_init, std::mutex); Zephyr's default pool
# of 5 POSIX mutexes runs out ("failed to initialize mutex, error code: 12" at run time).
CONFIG_MAX_PTHREAD_MUTEX_COUNT=64
```

## src/main.cpp
```c
// SPDX-License-Identifier: Apache-2.0
//
// Entry point for running one unmodified XNNPACK GoogleTest file on Zephyr or bare metal (both build
// modes of this app share this file). The test file itself
// (XNNPACK test/<name>.cc) supplies the TEST()s; XNNPACK's CMake would link gtest_main, but that needs
// a hosted environment, so this is the only code of ours: initialise GoogleTest, run, and leave through
// the BSP (Zephyr) or HTIF (bare metal, baremetal/src/htif.c) so the host (Spike/uart_tsi) sees the
// result as the exit code.
//
// Credits: the main() shape is GoogleTest's own gtest_main.cc (google/googletest, BSD-3-Clause);
// chipyard_sim_exit usage as in executorch/smolvla/src/riscv_executor_runner.cpp of this repo.
#include <stdio.h>

#include <gtest/gtest.h>

#ifdef __ZEPHYR__
#include <zephyr/toolchain.h>

extern "C" {
#include <chipyard/sim_exit.h>
}
#else
// Bare metal: exit() runs picolibc's exit handlers and ends in _exit() = HTIF "tohost" write (htif.c).
#include <stdlib.h>
static inline void chipyard_sim_exit(int code) { exit(code); }
#endif

int main(void) {
  // No command line on the chip: pass the filter chosen at build time (XNN_TEST_FILTER, empty = all).
  int argc = 1;
  char name[] = "xnnpack-test";
  char filter[] = "--gtest_filter=" XNN_TEST_FILTER;
  // XNN_TEST_SEED: the tests seed their random numbers from GoogleTest's random seed
  // (UnitTest::random_seed()), which is 0 -> time-based unless --gtest_shuffle is given. Spike's clock is
  // deterministic, so without a seed every run of one binary gets the same "random" numbers. A fixed seed
  // can be chosen at build time; it needs --gtest_shuffle too (test ORDER is then shuffled, results do not
  // depend on it). Default (empty): GoogleTest's own behaviour, no shuffle.
  char seed[] = "--gtest_random_seed=" XNN_TEST_SEED;
  char shuffle[] = "--gtest_shuffle";
  char* argv[5] = {name, nullptr, nullptr, nullptr, nullptr};
  if (sizeof(XNN_TEST_FILTER) > 1) {
    argv[argc++] = filter;
  }
  if (sizeof(XNN_TEST_SEED) > 1) {
    argv[argc++] = shuffle;
    argv[argc++] = seed;
  }
  printf("XNNPACK test %s, filter '%s', seed '%s'\n", XNN_TEST_NAME, XNN_TEST_FILTER, XNN_TEST_SEED);
  testing::InitGoogleTest(&argc, argv);
  int rc = RUN_ALL_TESTS();
  printf("%s (rc=%d)\n", rc == 0 ? "ALL TESTS PASSED" : "TESTS FAILED", rc);
  chipyard_sim_exit(rc);
  return rc;
}
```
