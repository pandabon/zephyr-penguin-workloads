## atlas/isa/sample.yaml
```yaml
# SPDX-License-Identifier: Apache-2.0
# GENERATED by: scripts/gen_atlas_isa_tests.py --atlas-dir third_party/tapeout-chipyard/generators/sp26-atlas-acc/baremetal --emit-sample-yaml
# One scenario per Atlas ISA-level baremetal test (baremetal/assembly/*.S, 121) and board variant.
# Build-only: plain Spike has no Atlas (see the README for running them with the Atlas Spike model).
# run_tests.py builds only the board it is given, so the vcu118_ta scenarios SKIP on the default board.
sample:
  name: atlas_isa
common:
  tags: atlas hardware atlas_isa
  build_only: true
tests:
  sample.penguin.atlas_isa.alu_basic:
    platform_allow: chipyard_penguin/penguin
    extra_args: ATLAS_ISA_TEST=alu_basic
  sample.penguin.vcu118_ta.atlas_isa.alu_basic:
    platform_allow: chipyard_penguin/penguin/vcu118_ta
    extra_args: ATLAS_ISA_TEST=alu_basic
  sample.penguin.atlas_isa.branch_accel_delay_slots_dma_vpu_xlu:
    platform_allow: chipyard_penguin/penguin
    extra_args: ATLAS_ISA_TEST=branch_accel_delay_slots_dma_vpu_xlu
  sample.penguin.vcu118_ta.atlas_isa.branch_accel_delay_slots_dma_vpu_xlu:
    platform_allow: chipyard_penguin/penguin/vcu118_ta
    extra_args: ATLAS_ISA_TEST=branch_accel_delay_slots_dma_vpu_xlu
  sample.penguin.atlas_isa.branch_delay_slots:
    platform_allow: chipyard_penguin/penguin
    extra_args: ATLAS_ISA_TEST=branch_delay_slots
  sample.penguin.vcu118_ta.atlas_isa.branch_delay_slots:
    platform_allow: chipyard_penguin/penguin/vcu118_ta
    extra_args: ATLAS_ISA_TEST=branch_delay_slots
  sample.penguin.atlas_isa.branch_delay_slots_mxu1_highbank_transpose:
    platform_allow: chipyard_penguin/penguin
    extra_args: ATLAS_ISA_TEST=branch_delay_slots_mxu1_highbank_transpose
  sample.penguin.vcu118_ta.atlas_isa.branch_delay_slots_mxu1_highbank_transpose:
    platform_allow: chipyard_penguin/penguin/vcu118_ta
    extra_args: ATLAS_ISA_TEST=branch_delay_slots_mxu1_highbank_transpose
  sample.penguin.atlas_isa.branch_on_accel_result_two_path_compute:
    platform_allow: chipyard_penguin/penguin
    extra_args: ATLAS_ISA_TEST=branch_on_accel_result_two_path_compute
  sample.penguin.vcu118_ta.atlas_isa.branch_on_accel_result_two_path_compute:
    platform_allow: chipyard_penguin/penguin/vcu118_ta
    extra_args: ATLAS_ISA_TEST=branch_on_accel_result_two_path_compute
  sample.penguin.atlas_isa.csr_scale:
    platform_allow: chipyard_penguin/penguin
    extra_args: ATLAS_ISA_TEST=csr_scale
  sample.penguin.vcu118_ta.atlas_isa.csr_scale:
    platform_allow: chipyard_penguin/penguin/vcu118_ta
    extra_args: ATLAS_ISA_TEST=csr_scale
  sample.penguin.atlas_isa.dma_8_channel_burst:
    platform_allow: chipyard_penguin/penguin
    extra_args: ATLAS_ISA_TEST=dma_8_channel_burst
  sample.penguin.vcu118_ta.atlas_isa.dma_8_channel_burst:
    platform_allow: chipyard_penguin/penguin/vcu118_ta
    extra_args: ATLAS_ISA_TEST=dma_8_channel_burst
  sample.penguin.atlas_isa.dma_bank_end_edges:
    platform_allow: chipyard_penguin/penguin
    extra_args: ATLAS_ISA_TEST=dma_bank_end_edges
  sample.penguin.vcu118_ta.atlas_isa.dma_bank_end_edges:
    platform_allow: chipyard_penguin/penguin/vcu118_ta
    extra_args: ATLAS_ISA_TEST=dma_bank_end_edges
  sample.penguin.atlas_isa.dma_compute_control_serialized_pipeline:
    platform_allow: chipyard_penguin/penguin
    extra_args: ATLAS_ISA_TEST=dma_compute_control_serialized_pipeline
  sample.penguin.vcu118_ta.atlas_isa.dma_compute_control_serialized_pipeline:
    platform_allow: chipyard_penguin/penguin/vcu118_ta
    extra_args: ATLAS_ISA_TEST=dma_compute_control_serialized_pipeline
  sample.penguin.atlas_isa.dma_loopback:
    platform_allow: chipyard_penguin/penguin
    extra_args: ATLAS_ISA_TEST=dma_loopback
  sample.penguin.vcu118_ta.atlas_isa.dma_loopback:
    platform_allow: chipyard_penguin/penguin/vcu118_ta
    extra_args: ATLAS_ISA_TEST=dma_loopback
  sample.penguin.atlas_isa.dma_lsu_stall_mixed:
    platform_allow: chipyard_penguin/penguin
    extra_args: ATLAS_ISA_TEST=dma_lsu_stall_mixed
  sample.penguin.vcu118_ta.atlas_isa.dma_lsu_stall_mixed:
    platform_allow: chipyard_penguin/penguin/vcu118_ta
    extra_args: ATLAS_ISA_TEST=dma_lsu_stall_mixed
  sample.penguin.atlas_isa.dma_mixed_direction_burst:
    platform_allow: chipyard_penguin/penguin
    extra_args: ATLAS_ISA_TEST=dma_mixed_direction_burst
  sample.penguin.vcu118_ta.atlas_isa.dma_mixed_direction_burst:
    platform_allow: chipyard_penguin/penguin/vcu118_ta
    extra_args: ATLAS_ISA_TEST=dma_mixed_direction_burst
  sample.penguin.atlas_isa.dma_mixed_transfer_sizes:
    platform_allow: chipyard_penguin/penguin
    extra_args: ATLAS_ISA_TEST=dma_mixed_transfer_sizes
  sample.penguin.vcu118_ta.atlas_isa.dma_mixed_transfer_sizes:
    platform_allow: chipyard_penguin/penguin/vcu118_ta
    extra_args: ATLAS_ISA_TEST=dma_mixed_transfer_sizes
  sample.penguin.atlas_isa.dma_overlap:
    platform_allow: chipyard_penguin/penguin
    extra_args: ATLAS_ISA_TEST=dma_overlap
  sample.penguin.vcu118_ta.atlas_isa.dma_overlap:
    platform_allow: chipyard_penguin/penguin/vcu118_ta
    extra_args: ATLAS_ISA_TEST=dma_overlap
  sample.penguin.atlas_isa.dma_reconfig_base:
    platform_allow: chipyard_penguin/penguin
    extra_args: ATLAS_ISA_TEST=dma_reconfig_base
  sample.penguin.vcu118_ta.atlas_isa.dma_reconfig_base:
    platform_allow: chipyard_penguin/penguin/vcu118_ta
    extra_args: ATLAS_ISA_TEST=dma_reconfig_base
  sample.penguin.atlas_isa.dma_reconfig_exhaustive:
    platform_allow: chipyard_penguin/penguin
    extra_args: ATLAS_ISA_TEST=dma_reconfig_exhaustive
  sample.penguin.vcu118_ta.atlas_isa.dma_reconfig_exhaustive:
    platform_allow: chipyard_penguin/penguin/vcu118_ta
    extra_args: ATLAS_ISA_TEST=dma_reconfig_exhaustive
  sample.penguin.atlas_isa.dma_stress:
    platform_allow: chipyard_penguin/penguin
    extra_args: ATLAS_ISA_TEST=dma_stress
  sample.penguin.vcu118_ta.atlas_isa.dma_stress:
    platform_allow: chipyard_penguin/penguin/vcu118_ta
    extra_args: ATLAS_ISA_TEST=dma_stress
  sample.penguin.atlas_isa.dual_mxu_pipeline_vpu:
    platform_allow: chipyard_penguin/penguin
    extra_args: ATLAS_ISA_TEST=dual_mxu_pipeline_vpu
  sample.penguin.vcu118_ta.atlas_isa.dual_mxu_pipeline_vpu:
    platform_allow: chipyard_penguin/penguin/vcu118_ta
    extra_args: ATLAS_ISA_TEST=dual_mxu_pipeline_vpu
  sample.penguin.atlas_isa.integ_bank_sweep_vpu_relu_dma:
    platform_allow: chipyard_penguin/penguin
    extra_args: ATLAS_ISA_TEST=integ_bank_sweep_vpu_relu_dma
  sample.penguin.vcu118_ta.atlas_isa.integ_bank_sweep_vpu_relu_dma:
    platform_allow: chipyard_penguin/penguin/vcu118_ta
    extra_args: ATLAS_ISA_TEST=integ_bank_sweep_vpu_relu_dma
  sample.penguin.atlas_isa.integ_reduction_recip_pack_branch_scalar:
    platform_allow: chipyard_penguin/penguin
    extra_args: ATLAS_ISA_TEST=integ_reduction_recip_pack_branch_scalar
  sample.penguin.vcu118_ta.atlas_isa.integ_reduction_recip_pack_branch_scalar:
    platform_allow: chipyard_penguin/penguin/vcu118_ta
    extra_args: ATLAS_ISA_TEST=integ_reduction_recip_pack_branch_scalar
  sample.penguin.atlas_isa.integ_xlu_multi_consumer_bank_sweep:
    platform_allow: chipyard_penguin/penguin
    extra_args: ATLAS_ISA_TEST=integ_xlu_multi_consumer_bank_sweep
  sample.penguin.vcu118_ta.atlas_isa.integ_xlu_multi_consumer_bank_sweep:
    platform_allow: chipyard_penguin/penguin/vcu118_ta
    extra_args: ATLAS_ISA_TEST=integ_xlu_multi_consumer_bank_sweep
  sample.penguin.atlas_isa.jal_jalr:
    platform_allow: chipyard_penguin/penguin
    extra_args: ATLAS_ISA_TEST=jal_jalr
  sample.penguin.vcu118_ta.atlas_isa.jal_jalr:
    platform_allow: chipyard_penguin/penguin/vcu118_ta
    extra_args: ATLAS_ISA_TEST=jal_jalr
  sample.penguin.atlas_isa.lsu_triple_overlap:
    platform_allow: chipyard_penguin/penguin
    extra_args: ATLAS_ISA_TEST=lsu_triple_overlap
  sample.penguin.vcu118_ta.atlas_isa.lsu_triple_overlap:
    platform_allow: chipyard_penguin/penguin/vcu118_ta
    extra_args: ATLAS_ISA_TEST=lsu_triple_overlap
  sample.penguin.atlas_isa.mem_scalar:
    platform_allow: chipyard_penguin/penguin
    extra_args: ATLAS_ISA_TEST=mem_scalar
  sample.penguin.vcu118_ta.atlas_isa.mem_scalar:
    platform_allow: chipyard_penguin/penguin/vcu118_ta
    extra_args: ATLAS_ISA_TEST=mem_scalar
  sample.penguin.atlas_isa.mreg_busy_state_rotator_cross_engine:
    platform_allow: chipyard_penguin/penguin
    extra_args: ATLAS_ISA_TEST=mreg_busy_state_rotator_cross_engine
  sample.penguin.vcu118_ta.atlas_isa.mreg_busy_state_rotator_cross_engine:
    platform_allow: chipyard_penguin/penguin/vcu118_ta
    extra_args: ATLAS_ISA_TEST=mreg_busy_state_rotator_cross_engine
  sample.penguin.atlas_isa.mreg_cross_engine_full_rotor:
    platform_allow: chipyard_penguin/penguin
    extra_args: ATLAS_ISA_TEST=mreg_cross_engine_full_rotor
  sample.penguin.vcu118_ta.atlas_isa.mreg_cross_engine_full_rotor:
    platform_allow: chipyard_penguin/penguin/vcu118_ta
    extra_args: ATLAS_ISA_TEST=mreg_cross_engine_full_rotor
  sample.penguin.atlas_isa.mreg_tracker_full_sweep:
    platform_allow: chipyard_penguin/penguin
    extra_args: ATLAS_ISA_TEST=mreg_tracker_full_sweep
  sample.penguin.vcu118_ta.atlas_isa.mreg_tracker_full_sweep:
    platform_allow: chipyard_penguin/penguin/vcu118_ta
    extra_args: ATLAS_ISA_TEST=mreg_tracker_full_sweep
  sample.penguin.atlas_isa.mreg_upper_bank_sweep_cross_engine:
    platform_allow: chipyard_penguin/penguin
    extra_args: ATLAS_ISA_TEST=mreg_upper_bank_sweep_cross_engine
  sample.penguin.vcu118_ta.atlas_isa.mreg_upper_bank_sweep_cross_engine:
    platform_allow: chipyard_penguin/penguin/vcu118_ta
    extra_args: ATLAS_ISA_TEST=mreg_upper_bank_sweep_cross_engine
  sample.penguin.atlas_isa.mxu0_more_push_pop:
    platform_allow: chipyard_penguin/penguin
    extra_args: ATLAS_ISA_TEST=mxu0_more_push_pop
  sample.penguin.vcu118_ta.atlas_isa.mxu0_more_push_pop:
    platform_allow: chipyard_penguin/penguin/vcu118_ta
    extra_args: ATLAS_ISA_TEST=mxu0_more_push_pop
  sample.penguin.atlas_isa.mxu0_push_pop:
    platform_allow: chipyard_penguin/penguin
    extra_args: ATLAS_ISA_TEST=mxu0_push_pop
  sample.penguin.vcu118_ta.atlas_isa.mxu0_push_pop:
    platform_allow: chipyard_penguin/penguin/vcu118_ta
    extra_args: ATLAS_ISA_TEST=mxu0_push_pop
  sample.penguin.atlas_isa.mxu0_qk_scores:
    platform_allow: chipyard_penguin/penguin
    extra_args: ATLAS_ISA_TEST=mxu0_qk_scores
  sample.penguin.vcu118_ta.atlas_isa.mxu0_qk_scores:
    platform_allow: chipyard_penguin/penguin/vcu118_ta
    extra_args: ATLAS_ISA_TEST=mxu0_qk_scores
  sample.penguin.atlas_isa.mxu0_single_input_tile_bf16:
    platform_allow: chipyard_penguin/penguin
    extra_args: ATLAS_ISA_TEST=mxu0_single_input_tile_bf16
  sample.penguin.vcu118_ta.atlas_isa.mxu0_single_input_tile_bf16:
    platform_allow: chipyard_penguin/penguin/vcu118_ta
    extra_args: ATLAS_ISA_TEST=mxu0_single_input_tile_bf16
  sample.penguin.atlas_isa.mxu0_single_output_tile_bf16:
    platform_allow: chipyard_penguin/penguin
    extra_args: ATLAS_ISA_TEST=mxu0_single_output_tile_bf16
  sample.penguin.vcu118_ta.atlas_isa.mxu0_single_output_tile_bf16:
    platform_allow: chipyard_penguin/penguin/vcu118_ta
    extra_args: ATLAS_ISA_TEST=mxu0_single_output_tile_bf16
  sample.penguin.atlas_isa.mxu0_single_output_tile_bf16_k96:
    platform_allow: chipyard_penguin/penguin
    extra_args: ATLAS_ISA_TEST=mxu0_single_output_tile_bf16_k96
  sample.penguin.vcu118_ta.atlas_isa.mxu0_single_output_tile_bf16_k96:
    platform_allow: chipyard_penguin/penguin/vcu118_ta
    extra_args: ATLAS_ISA_TEST=mxu0_single_output_tile_bf16_k96
  sample.penguin.atlas_isa.mxu1_more_push_pop:
    platform_allow: chipyard_penguin/penguin
    extra_args: ATLAS_ISA_TEST=mxu1_more_push_pop
  sample.penguin.vcu118_ta.atlas_isa.mxu1_more_push_pop:
    platform_allow: chipyard_penguin/penguin/vcu118_ta
    extra_args: ATLAS_ISA_TEST=mxu1_more_push_pop
  sample.penguin.atlas_isa.mxu1_push_pop:
    platform_allow: chipyard_penguin/penguin
    extra_args: ATLAS_ISA_TEST=mxu1_push_pop
  sample.penguin.vcu118_ta.atlas_isa.mxu1_push_pop:
    platform_allow: chipyard_penguin/penguin/vcu118_ta
    extra_args: ATLAS_ISA_TEST=mxu1_push_pop
  sample.penguin.atlas_isa.mxu1_qk_scores:
    platform_allow: chipyard_penguin/penguin
    extra_args: ATLAS_ISA_TEST=mxu1_qk_scores
  sample.penguin.vcu118_ta.atlas_isa.mxu1_qk_scores:
    platform_allow: chipyard_penguin/penguin/vcu118_ta
    extra_args: ATLAS_ISA_TEST=mxu1_qk_scores
  sample.penguin.atlas_isa.mxu1_quant_relu_roundtrip:
    platform_allow: chipyard_penguin/penguin
    extra_args: ATLAS_ISA_TEST=mxu1_quant_relu_roundtrip
  sample.penguin.vcu118_ta.atlas_isa.mxu1_quant_relu_roundtrip:
    platform_allow: chipyard_penguin/penguin/vcu118_ta
    extra_args: ATLAS_ISA_TEST=mxu1_quant_relu_roundtrip
  sample.penguin.atlas_isa.mxu1_single_input_tile_bf16:
    platform_allow: chipyard_penguin/penguin
    extra_args: ATLAS_ISA_TEST=mxu1_single_input_tile_bf16
  sample.penguin.vcu118_ta.atlas_isa.mxu1_single_input_tile_bf16:
    platform_allow: chipyard_penguin/penguin/vcu118_ta
    extra_args: ATLAS_ISA_TEST=mxu1_single_input_tile_bf16
  sample.penguin.atlas_isa.mxu1_single_output_tile_bf16:
    platform_allow: chipyard_penguin/penguin
    extra_args: ATLAS_ISA_TEST=mxu1_single_output_tile_bf16
  sample.penguin.vcu118_ta.atlas_isa.mxu1_single_output_tile_bf16:
    platform_allow: chipyard_penguin/penguin/vcu118_ta
    extra_args: ATLAS_ISA_TEST=mxu1_single_output_tile_bf16
  sample.penguin.atlas_isa.mxu1_single_output_tile_bf16_k96:
    platform_allow: chipyard_penguin/penguin
    extra_args: ATLAS_ISA_TEST=mxu1_single_output_tile_bf16_k96
  sample.penguin.vcu118_ta.atlas_isa.mxu1_single_output_tile_bf16_k96:
    platform_allow: chipyard_penguin/penguin/vcu118_ta
    extra_args: ATLAS_ISA_TEST=mxu1_single_output_tile_bf16_k96
  sample.penguin.atlas_isa.mxu_chain_vpu_reduce:
    platform_allow: chipyard_penguin/penguin
    extra_args: ATLAS_ISA_TEST=mxu_chain_vpu_reduce
  sample.penguin.vcu118_ta.atlas_isa.mxu_chain_vpu_reduce:
    platform_allow: chipyard_penguin/penguin/vcu118_ta
    extra_args: ATLAS_ISA_TEST=mxu_chain_vpu_reduce
  sample.penguin.atlas_isa.perf_fused_attention_mxu0:
    platform_allow: chipyard_penguin/penguin
    extra_args: ATLAS_ISA_TEST=perf_fused_attention_mxu0
  sample.penguin.vcu118_ta.atlas_isa.perf_fused_attention_mxu0:
    platform_allow: chipyard_penguin/penguin/vcu118_ta
    extra_args: ATLAS_ISA_TEST=perf_fused_attention_mxu0
  sample.penguin.atlas_isa.perf_fused_attention_mxu1:
    platform_allow: chipyard_penguin/penguin
    extra_args: ATLAS_ISA_TEST=perf_fused_attention_mxu1
  sample.penguin.vcu118_ta.atlas_isa.perf_fused_attention_mxu1:
    platform_allow: chipyard_penguin/penguin/vcu118_ta
    extra_args: ATLAS_ISA_TEST=perf_fused_attention_mxu1
  sample.penguin.atlas_isa.perf_mm_dual_128x128x128:
    platform_allow: chipyard_penguin/penguin
    extra_args: ATLAS_ISA_TEST=perf_mm_dual_128x128x128
  sample.penguin.vcu118_ta.atlas_isa.perf_mm_dual_128x128x128:
    platform_allow: chipyard_penguin/penguin/vcu118_ta
    extra_args: ATLAS_ISA_TEST=perf_mm_dual_128x128x128
  sample.penguin.atlas_isa.perf_mm_mxu0_64x64x128:
    platform_allow: chipyard_penguin/penguin
    extra_args: ATLAS_ISA_TEST=perf_mm_mxu0_64x64x128
  sample.penguin.vcu118_ta.atlas_isa.perf_mm_mxu0_64x64x128:
    platform_allow: chipyard_penguin/penguin/vcu118_ta
    extra_args: ATLAS_ISA_TEST=perf_mm_mxu0_64x64x128
  sample.penguin.atlas_isa.perf_mm_mxu0_64x64x64:
    platform_allow: chipyard_penguin/penguin
    extra_args: ATLAS_ISA_TEST=perf_mm_mxu0_64x64x64
  sample.penguin.vcu118_ta.atlas_isa.perf_mm_mxu0_64x64x64:
    platform_allow: chipyard_penguin/penguin/vcu118_ta
    extra_args: ATLAS_ISA_TEST=perf_mm_mxu0_64x64x64
  sample.penguin.atlas_isa.perf_mm_mxu1_64x64x128:
    platform_allow: chipyard_penguin/penguin
    extra_args: ATLAS_ISA_TEST=perf_mm_mxu1_64x64x128
  sample.penguin.vcu118_ta.atlas_isa.perf_mm_mxu1_64x64x128:
    platform_allow: chipyard_penguin/penguin/vcu118_ta
    extra_args: ATLAS_ISA_TEST=perf_mm_mxu1_64x64x128
  sample.penguin.atlas_isa.perf_mm_mxu1_64x64x64:
    platform_allow: chipyard_penguin/penguin
    extra_args: ATLAS_ISA_TEST=perf_mm_mxu1_64x64x64
  sample.penguin.vcu118_ta.atlas_isa.perf_mm_mxu1_64x64x64:
    platform_allow: chipyard_penguin/penguin/vcu118_ta
    extra_args: ATLAS_ISA_TEST=perf_mm_mxu1_64x64x64
  sample.penguin.atlas_isa.perf_mm_single:
    platform_allow: chipyard_penguin/penguin
    extra_args: ATLAS_ISA_TEST=perf_mm_single
  sample.penguin.vcu118_ta.atlas_isa.perf_mm_single:
    platform_allow: chipyard_penguin/penguin/vcu118_ta
    extra_args: ATLAS_ISA_TEST=perf_mm_single
  sample.penguin.atlas_isa.perf_softmax:
    platform_allow: chipyard_penguin/penguin
    extra_args: ATLAS_ISA_TEST=perf_softmax
  sample.penguin.vcu118_ta.atlas_isa.perf_softmax:
    platform_allow: chipyard_penguin/penguin/vcu118_ta
    extra_args: ATLAS_ISA_TEST=perf_softmax
  sample.penguin.atlas_isa.perf_unary:
    platform_allow: chipyard_penguin/penguin
    extra_args: ATLAS_ISA_TEST=perf_unary
  sample.penguin.vcu118_ta.atlas_isa.perf_unary:
    platform_allow: chipyard_penguin/penguin/vcu118_ta
    extra_args: ATLAS_ISA_TEST=perf_unary
  sample.penguin.atlas_isa.perf_vec_layernorm_32x32:
    platform_allow: chipyard_penguin/penguin
    extra_args: ATLAS_ISA_TEST=perf_vec_layernorm_32x32
  sample.penguin.vcu118_ta.atlas_isa.perf_vec_layernorm_32x32:
    platform_allow: chipyard_penguin/penguin/vcu118_ta
    extra_args: ATLAS_ISA_TEST=perf_vec_layernorm_32x32
  sample.penguin.atlas_isa.perf_vec_rmsnorm_softmax:
    platform_allow: chipyard_penguin/penguin
    extra_args: ATLAS_ISA_TEST=perf_vec_rmsnorm_softmax
  sample.penguin.vcu118_ta.atlas_isa.perf_vec_rmsnorm_softmax:
    platform_allow: chipyard_penguin/penguin/vcu118_ta
    extra_args: ATLAS_ISA_TEST=perf_vec_rmsnorm_softmax
  sample.penguin.atlas_isa.perf_vpu_binary:
    platform_allow: chipyard_penguin/penguin
    extra_args: ATLAS_ISA_TEST=perf_vpu_binary
  sample.penguin.vcu118_ta.atlas_isa.perf_vpu_binary:
    platform_allow: chipyard_penguin/penguin/vcu118_ta
    extra_args: ATLAS_ISA_TEST=perf_vpu_binary
  sample.penguin.atlas_isa.perf_vpu_reduction:
    platform_allow: chipyard_penguin/penguin
    extra_args: ATLAS_ISA_TEST=perf_vpu_reduction
  sample.penguin.vcu118_ta.atlas_isa.perf_vpu_reduction:
    platform_allow: chipyard_penguin/penguin/vcu118_ta
    extra_args: ATLAS_ISA_TEST=perf_vpu_reduction
  sample.penguin.atlas_isa.pw_vpu_overlap_pointwise_pack:
    platform_allow: chipyard_penguin/penguin
    extra_args: ATLAS_ISA_TEST=pw_vpu_overlap_pointwise_pack
  sample.penguin.vcu118_ta.atlas_isa.pw_vpu_overlap_pointwise_pack:
    platform_allow: chipyard_penguin/penguin/vcu118_ta
    extra_args: ATLAS_ISA_TEST=pw_vpu_overlap_pointwise_pack
  sample.penguin.atlas_isa.pw_vpu_overlap_reduce_vli:
    platform_allow: chipyard_penguin/penguin
    extra_args: ATLAS_ISA_TEST=pw_vpu_overlap_reduce_vli
  sample.penguin.vcu118_ta.atlas_isa.pw_vpu_overlap_reduce_vli:
    platform_allow: chipyard_penguin/penguin/vcu118_ta
    extra_args: ATLAS_ISA_TEST=pw_vpu_overlap_reduce_vli
  sample.penguin.atlas_isa.scalar_isa:
    platform_allow: chipyard_penguin/penguin
    extra_args: ATLAS_ISA_TEST=scalar_isa
  sample.penguin.vcu118_ta.atlas_isa.scalar_isa:
    platform_allow: chipyard_penguin/penguin/vcu118_ta
    extra_args: ATLAS_ISA_TEST=scalar_isa
  sample.penguin.atlas_isa.scalar_subword_high_offsets:
    platform_allow: chipyard_penguin/penguin
    extra_args: ATLAS_ISA_TEST=scalar_subword_high_offsets
  sample.penguin.vcu118_ta.atlas_isa.scalar_subword_high_offsets:
    platform_allow: chipyard_penguin/penguin/vcu118_ta
    extra_args: ATLAS_ISA_TEST=scalar_subword_high_offsets
  sample.penguin.atlas_isa.scalar_vector_concurrent:
    platform_allow: chipyard_penguin/penguin
    extra_args: ATLAS_ISA_TEST=scalar_vector_concurrent
  sample.penguin.vcu118_ta.atlas_isa.scalar_vector_concurrent:
    platform_allow: chipyard_penguin/penguin/vcu118_ta
    extra_args: ATLAS_ISA_TEST=scalar_vector_concurrent
  sample.penguin.atlas_isa.smolvla_attention:
    platform_allow: chipyard_penguin/penguin
    extra_args: ATLAS_ISA_TEST=smolvla_attention
  sample.penguin.vcu118_ta.atlas_isa.smolvla_attention:
    platform_allow: chipyard_penguin/penguin/vcu118_ta
    extra_args: ATLAS_ISA_TEST=smolvla_attention
  sample.penguin.atlas_isa.smolvla_elementwise_add:
    platform_allow: chipyard_penguin/penguin
    extra_args: ATLAS_ISA_TEST=smolvla_elementwise_add
  sample.penguin.vcu118_ta.atlas_isa.smolvla_elementwise_add:
    platform_allow: chipyard_penguin/penguin/vcu118_ta
    extra_args: ATLAS_ISA_TEST=smolvla_elementwise_add
  sample.penguin.atlas_isa.smolvla_elementwise_div:
    platform_allow: chipyard_penguin/penguin
    extra_args: ATLAS_ISA_TEST=smolvla_elementwise_div
  sample.penguin.vcu118_ta.atlas_isa.smolvla_elementwise_div:
    platform_allow: chipyard_penguin/penguin/vcu118_ta
    extra_args: ATLAS_ISA_TEST=smolvla_elementwise_div
  sample.penguin.atlas_isa.smolvla_elementwise_mul:
    platform_allow: chipyard_penguin/penguin
    extra_args: ATLAS_ISA_TEST=smolvla_elementwise_mul
  sample.penguin.vcu118_ta.atlas_isa.smolvla_elementwise_mul:
    platform_allow: chipyard_penguin/penguin/vcu118_ta
    extra_args: ATLAS_ISA_TEST=smolvla_elementwise_mul
  sample.penguin.atlas_isa.smolvla_elementwise_sub:
    platform_allow: chipyard_penguin/penguin
    extra_args: ATLAS_ISA_TEST=smolvla_elementwise_sub
  sample.penguin.vcu118_ta.atlas_isa.smolvla_elementwise_sub:
    platform_allow: chipyard_penguin/penguin/vcu118_ta
    extra_args: ATLAS_ISA_TEST=smolvla_elementwise_sub
  sample.penguin.atlas_isa.smolvla_fused_attention:
    platform_allow: chipyard_penguin/penguin
    extra_args: ATLAS_ISA_TEST=smolvla_fused_attention
  sample.penguin.vcu118_ta.atlas_isa.smolvla_fused_attention:
    platform_allow: chipyard_penguin/penguin/vcu118_ta
    extra_args: ATLAS_ISA_TEST=smolvla_fused_attention
  sample.penguin.atlas_isa.smolvla_fused_matmul_bias_mxu0:
    platform_allow: chipyard_penguin/penguin
    extra_args: ATLAS_ISA_TEST=smolvla_fused_matmul_bias_mxu0
  sample.penguin.vcu118_ta.atlas_isa.smolvla_fused_matmul_bias_mxu0:
    platform_allow: chipyard_penguin/penguin/vcu118_ta
    extra_args: ATLAS_ISA_TEST=smolvla_fused_matmul_bias_mxu0
  sample.penguin.atlas_isa.smolvla_fused_matmul_bias_mxu1:
    platform_allow: chipyard_penguin/penguin
    extra_args: ATLAS_ISA_TEST=smolvla_fused_matmul_bias_mxu1
  sample.penguin.vcu118_ta.atlas_isa.smolvla_fused_matmul_bias_mxu1:
    platform_allow: chipyard_penguin/penguin/vcu118_ta
    extra_args: ATLAS_ISA_TEST=smolvla_fused_matmul_bias_mxu1
  sample.penguin.atlas_isa.smolvla_fused_matmul_bias_v2_mxu0:
    platform_allow: chipyard_penguin/penguin
    extra_args: ATLAS_ISA_TEST=smolvla_fused_matmul_bias_v2_mxu0
  sample.penguin.vcu118_ta.atlas_isa.smolvla_fused_matmul_bias_v2_mxu0:
    platform_allow: chipyard_penguin/penguin/vcu118_ta
    extra_args: ATLAS_ISA_TEST=smolvla_fused_matmul_bias_v2_mxu0
  sample.penguin.atlas_isa.smolvla_fused_matmul_bias_v2_mxu1:
    platform_allow: chipyard_penguin/penguin
    extra_args: ATLAS_ISA_TEST=smolvla_fused_matmul_bias_v2_mxu1
  sample.penguin.vcu118_ta.atlas_isa.smolvla_fused_matmul_bias_v2_mxu1:
    platform_allow: chipyard_penguin/penguin/vcu118_ta
    extra_args: ATLAS_ISA_TEST=smolvla_fused_matmul_bias_v2_mxu1
  sample.penguin.atlas_isa.smolvla_fused_norm_scale:
    platform_allow: chipyard_penguin/penguin
    extra_args: ATLAS_ISA_TEST=smolvla_fused_norm_scale
  sample.penguin.vcu118_ta.atlas_isa.smolvla_fused_norm_scale:
    platform_allow: chipyard_penguin/penguin/vcu118_ta
    extra_args: ATLAS_ISA_TEST=smolvla_fused_norm_scale
  sample.penguin.atlas_isa.smolvla_fused_silu_gate:
    platform_allow: chipyard_penguin/penguin
    extra_args: ATLAS_ISA_TEST=smolvla_fused_silu_gate
  sample.penguin.vcu118_ta.atlas_isa.smolvla_fused_silu_gate:
    platform_allow: chipyard_penguin/penguin/vcu118_ta
    extra_args: ATLAS_ISA_TEST=smolvla_fused_silu_gate
  sample.penguin.atlas_isa.smolvla_gelu_tanh:
    platform_allow: chipyard_penguin/penguin
    extra_args: ATLAS_ISA_TEST=smolvla_gelu_tanh
  sample.penguin.vcu118_ta.atlas_isa.smolvla_gelu_tanh:
    platform_allow: chipyard_penguin/penguin/vcu118_ta
    extra_args: ATLAS_ISA_TEST=smolvla_gelu_tanh
  sample.penguin.atlas_isa.smolvla_matmul_k_chain_mxu0:
    platform_allow: chipyard_penguin/penguin
    extra_args: ATLAS_ISA_TEST=smolvla_matmul_k_chain_mxu0
  sample.penguin.vcu118_ta.atlas_isa.smolvla_matmul_k_chain_mxu0:
    platform_allow: chipyard_penguin/penguin/vcu118_ta
    extra_args: ATLAS_ISA_TEST=smolvla_matmul_k_chain_mxu0
  sample.penguin.atlas_isa.smolvla_matmul_k_chain_mxu1:
    platform_allow: chipyard_penguin/penguin
    extra_args: ATLAS_ISA_TEST=smolvla_matmul_k_chain_mxu1
  sample.penguin.vcu118_ta.atlas_isa.smolvla_matmul_k_chain_mxu1:
    platform_allow: chipyard_penguin/penguin/vcu118_ta
    extra_args: ATLAS_ISA_TEST=smolvla_matmul_k_chain_mxu1
  sample.penguin.atlas_isa.smolvla_matmul_mxu0:
    platform_allow: chipyard_penguin/penguin
    extra_args: ATLAS_ISA_TEST=smolvla_matmul_mxu0
  sample.penguin.vcu118_ta.atlas_isa.smolvla_matmul_mxu0:
    platform_allow: chipyard_penguin/penguin/vcu118_ta
    extra_args: ATLAS_ISA_TEST=smolvla_matmul_mxu0
  sample.penguin.atlas_isa.smolvla_matmul_mxu1:
    platform_allow: chipyard_penguin/penguin
    extra_args: ATLAS_ISA_TEST=smolvla_matmul_mxu1
  sample.penguin.vcu118_ta.atlas_isa.smolvla_matmul_mxu1:
    platform_allow: chipyard_penguin/penguin/vcu118_ta
    extra_args: ATLAS_ISA_TEST=smolvla_matmul_mxu1
  sample.penguin.atlas_isa.smolvla_parameterized_elementwise_add:
    platform_allow: chipyard_penguin/penguin
    extra_args: ATLAS_ISA_TEST=smolvla_parameterized_elementwise_add
  sample.penguin.vcu118_ta.atlas_isa.smolvla_parameterized_elementwise_add:
    platform_allow: chipyard_penguin/penguin/vcu118_ta
    extra_args: ATLAS_ISA_TEST=smolvla_parameterized_elementwise_add
  sample.penguin.atlas_isa.smolvla_parameterized_elementwise_div:
    platform_allow: chipyard_penguin/penguin
    extra_args: ATLAS_ISA_TEST=smolvla_parameterized_elementwise_div
  sample.penguin.vcu118_ta.atlas_isa.smolvla_parameterized_elementwise_div:
    platform_allow: chipyard_penguin/penguin/vcu118_ta
    extra_args: ATLAS_ISA_TEST=smolvla_parameterized_elementwise_div
  sample.penguin.atlas_isa.smolvla_parameterized_elementwise_mul:
    platform_allow: chipyard_penguin/penguin
    extra_args: ATLAS_ISA_TEST=smolvla_parameterized_elementwise_mul
  sample.penguin.vcu118_ta.atlas_isa.smolvla_parameterized_elementwise_mul:
    platform_allow: chipyard_penguin/penguin/vcu118_ta
    extra_args: ATLAS_ISA_TEST=smolvla_parameterized_elementwise_mul
  sample.penguin.atlas_isa.smolvla_parameterized_elementwise_sub:
    platform_allow: chipyard_penguin/penguin
    extra_args: ATLAS_ISA_TEST=smolvla_parameterized_elementwise_sub
  sample.penguin.vcu118_ta.atlas_isa.smolvla_parameterized_elementwise_sub:
    platform_allow: chipyard_penguin/penguin/vcu118_ta
    extra_args: ATLAS_ISA_TEST=smolvla_parameterized_elementwise_sub
  sample.penguin.atlas_isa.smolvla_parameterized_fused_matmul_bias:
    platform_allow: chipyard_penguin/penguin
    extra_args: ATLAS_ISA_TEST=smolvla_parameterized_fused_matmul_bias
  sample.penguin.vcu118_ta.atlas_isa.smolvla_parameterized_fused_matmul_bias:
    platform_allow: chipyard_penguin/penguin/vcu118_ta
    extra_args: ATLAS_ISA_TEST=smolvla_parameterized_fused_matmul_bias
  sample.penguin.atlas_isa.smolvla_parameterized_fused_norm_scale:
    platform_allow: chipyard_penguin/penguin
    extra_args: ATLAS_ISA_TEST=smolvla_parameterized_fused_norm_scale
  sample.penguin.vcu118_ta.atlas_isa.smolvla_parameterized_fused_norm_scale:
    platform_allow: chipyard_penguin/penguin/vcu118_ta
    extra_args: ATLAS_ISA_TEST=smolvla_parameterized_fused_norm_scale
  sample.penguin.atlas_isa.smolvla_parameterized_fused_silu_gate:
    platform_allow: chipyard_penguin/penguin
    extra_args: ATLAS_ISA_TEST=smolvla_parameterized_fused_silu_gate
  sample.penguin.vcu118_ta.atlas_isa.smolvla_parameterized_fused_silu_gate:
    platform_allow: chipyard_penguin/penguin/vcu118_ta
    extra_args: ATLAS_ISA_TEST=smolvla_parameterized_fused_silu_gate
  sample.penguin.atlas_isa.smolvla_parameterized_gelu_tanh:
    platform_allow: chipyard_penguin/penguin
    extra_args: ATLAS_ISA_TEST=smolvla_parameterized_gelu_tanh
  sample.penguin.vcu118_ta.atlas_isa.smolvla_parameterized_gelu_tanh:
    platform_allow: chipyard_penguin/penguin/vcu118_ta
    extra_args: ATLAS_ISA_TEST=smolvla_parameterized_gelu_tanh
  sample.penguin.atlas_isa.smolvla_parameterized_matmul:
    platform_allow: chipyard_penguin/penguin
    extra_args: ATLAS_ISA_TEST=smolvla_parameterized_matmul
  sample.penguin.vcu118_ta.atlas_isa.smolvla_parameterized_matmul:
    platform_allow: chipyard_penguin/penguin/vcu118_ta
    extra_args: ATLAS_ISA_TEST=smolvla_parameterized_matmul
  sample.penguin.atlas_isa.smolvla_parameterized_reduction_sum:
    platform_allow: chipyard_penguin/penguin
    extra_args: ATLAS_ISA_TEST=smolvla_parameterized_reduction_sum
  sample.penguin.vcu118_ta.atlas_isa.smolvla_parameterized_reduction_sum:
    platform_allow: chipyard_penguin/penguin/vcu118_ta
    extra_args: ATLAS_ISA_TEST=smolvla_parameterized_reduction_sum
  sample.penguin.atlas_isa.smolvla_parameterized_requant:
    platform_allow: chipyard_penguin/penguin
    extra_args: ATLAS_ISA_TEST=smolvla_parameterized_requant
  sample.penguin.vcu118_ta.atlas_isa.smolvla_parameterized_requant:
    platform_allow: chipyard_penguin/penguin/vcu118_ta
    extra_args: ATLAS_ISA_TEST=smolvla_parameterized_requant
  sample.penguin.atlas_isa.smolvla_parameterized_rms_norm:
    platform_allow: chipyard_penguin/penguin
    extra_args: ATLAS_ISA_TEST=smolvla_parameterized_rms_norm
  sample.penguin.vcu118_ta.atlas_isa.smolvla_parameterized_rms_norm:
    platform_allow: chipyard_penguin/penguin/vcu118_ta
    extra_args: ATLAS_ISA_TEST=smolvla_parameterized_rms_norm
  sample.penguin.atlas_isa.smolvla_parameterized_rope_frequency:
    platform_allow: chipyard_penguin/penguin
    extra_args: ATLAS_ISA_TEST=smolvla_parameterized_rope_frequency
  sample.penguin.vcu118_ta.atlas_isa.smolvla_parameterized_rope_frequency:
    platform_allow: chipyard_penguin/penguin/vcu118_ta
    extra_args: ATLAS_ISA_TEST=smolvla_parameterized_rope_frequency
  sample.penguin.atlas_isa.smolvla_parameterized_silu:
    platform_allow: chipyard_penguin/penguin
    extra_args: ATLAS_ISA_TEST=smolvla_parameterized_silu
  sample.penguin.vcu118_ta.atlas_isa.smolvla_parameterized_silu:
    platform_allow: chipyard_penguin/penguin/vcu118_ta
    extra_args: ATLAS_ISA_TEST=smolvla_parameterized_silu
  sample.penguin.atlas_isa.smolvla_parameterized_softmax:
    platform_allow: chipyard_penguin/penguin
    extra_args: ATLAS_ISA_TEST=smolvla_parameterized_softmax
  sample.penguin.vcu118_ta.atlas_isa.smolvla_parameterized_softmax:
    platform_allow: chipyard_penguin/penguin/vcu118_ta
    extra_args: ATLAS_ISA_TEST=smolvla_parameterized_softmax
  sample.penguin.atlas_isa.smolvla_reduction_sum:
    platform_allow: chipyard_penguin/penguin
    extra_args: ATLAS_ISA_TEST=smolvla_reduction_sum
  sample.penguin.vcu118_ta.atlas_isa.smolvla_reduction_sum:
    platform_allow: chipyard_penguin/penguin/vcu118_ta
    extra_args: ATLAS_ISA_TEST=smolvla_reduction_sum
  sample.penguin.atlas_isa.smolvla_requant:
    platform_allow: chipyard_penguin/penguin
    extra_args: ATLAS_ISA_TEST=smolvla_requant
  sample.penguin.vcu118_ta.atlas_isa.smolvla_requant:
    platform_allow: chipyard_penguin/penguin/vcu118_ta
    extra_args: ATLAS_ISA_TEST=smolvla_requant
  sample.penguin.atlas_isa.smolvla_rms_norm:
    platform_allow: chipyard_penguin/penguin
    extra_args: ATLAS_ISA_TEST=smolvla_rms_norm
  sample.penguin.vcu118_ta.atlas_isa.smolvla_rms_norm:
    platform_allow: chipyard_penguin/penguin/vcu118_ta
    extra_args: ATLAS_ISA_TEST=smolvla_rms_norm
  sample.penguin.atlas_isa.smolvla_rope_frequency:
    platform_allow: chipyard_penguin/penguin
    extra_args: ATLAS_ISA_TEST=smolvla_rope_frequency
  sample.penguin.vcu118_ta.atlas_isa.smolvla_rope_frequency:
    platform_allow: chipyard_penguin/penguin/vcu118_ta
    extra_args: ATLAS_ISA_TEST=smolvla_rope_frequency
  sample.penguin.atlas_isa.smolvla_silu:
    platform_allow: chipyard_penguin/penguin
    extra_args: ATLAS_ISA_TEST=smolvla_silu
  sample.penguin.vcu118_ta.atlas_isa.smolvla_silu:
    platform_allow: chipyard_penguin/penguin/vcu118_ta
    extra_args: ATLAS_ISA_TEST=smolvla_silu
  sample.penguin.atlas_isa.smolvla_softmax:
    platform_allow: chipyard_penguin/penguin
    extra_args: ATLAS_ISA_TEST=smolvla_softmax
  sample.penguin.vcu118_ta.atlas_isa.smolvla_softmax:
    platform_allow: chipyard_penguin/penguin/vcu118_ta
    extra_args: ATLAS_ISA_TEST=smolvla_softmax
  sample.penguin.atlas_isa.triple_unit_concurrent:
    platform_allow: chipyard_penguin/penguin
    extra_args: ATLAS_ISA_TEST=triple_unit_concurrent
  sample.penguin.vcu118_ta.atlas_isa.triple_unit_concurrent:
    platform_allow: chipyard_penguin/penguin/vcu118_ta
    extra_args: ATLAS_ISA_TEST=triple_unit_concurrent
  sample.penguin.atlas_isa.vmem_contention_stress:
    platform_allow: chipyard_penguin/penguin
    extra_args: ATLAS_ISA_TEST=vmem_contention_stress
  sample.penguin.vcu118_ta.atlas_isa.vmem_contention_stress:
    platform_allow: chipyard_penguin/penguin/vcu118_ta
    extra_args: ATLAS_ISA_TEST=vmem_contention_stress
  sample.penguin.atlas_isa.vpu_binary:
    platform_allow: chipyard_penguin/penguin
    extra_args: ATLAS_ISA_TEST=vpu_binary
  sample.penguin.vcu118_ta.atlas_isa.vpu_binary:
    platform_allow: chipyard_penguin/penguin/vcu118_ta
    extra_args: ATLAS_ISA_TEST=vpu_binary
  sample.penguin.atlas_isa.vpu_col_reduce:
    platform_allow: chipyard_penguin/penguin
    extra_args: ATLAS_ISA_TEST=vpu_col_reduce
  sample.penguin.vcu118_ta.atlas_isa.vpu_col_reduce:
    platform_allow: chipyard_penguin/penguin/vcu118_ta
    extra_args: ATLAS_ISA_TEST=vpu_col_reduce
  sample.penguin.atlas_isa.vpu_exp_round_edge_blast:
    platform_allow: chipyard_penguin/penguin
    extra_args: ATLAS_ISA_TEST=vpu_exp_round_edge_blast
  sample.penguin.vcu118_ta.atlas_isa.vpu_exp_round_edge_blast:
    platform_allow: chipyard_penguin/penguin/vcu118_ta
    extra_args: ATLAS_ISA_TEST=vpu_exp_round_edge_blast
  sample.penguin.atlas_isa.vpu_lut_bitflip_megasweep:
    platform_allow: chipyard_penguin/penguin
    extra_args: ATLAS_ISA_TEST=vpu_lut_bitflip_megasweep
  sample.penguin.vcu118_ta.atlas_isa.vpu_lut_bitflip_megasweep:
    platform_allow: chipyard_penguin/penguin/vcu118_ta
    extra_args: ATLAS_ISA_TEST=vpu_lut_bitflip_megasweep
  sample.penguin.atlas_isa.vpu_lut_octave_oddexp_sweep:
    platform_allow: chipyard_penguin/penguin
    extra_args: ATLAS_ISA_TEST=vpu_lut_octave_oddexp_sweep
  sample.penguin.vcu118_ta.atlas_isa.vpu_lut_octave_oddexp_sweep:
    platform_allow: chipyard_penguin/penguin/vcu118_ta
    extra_args: ATLAS_ISA_TEST=vpu_lut_octave_oddexp_sweep
  sample.penguin.atlas_isa.vpu_lut_toggle_sweep:
    platform_allow: chipyard_penguin/penguin
    extra_args: ATLAS_ISA_TEST=vpu_lut_toggle_sweep
  sample.penguin.vcu118_ta.atlas_isa.vpu_lut_toggle_sweep:
    platform_allow: chipyard_penguin/penguin/vcu118_ta
    extra_args: ATLAS_ISA_TEST=vpu_lut_toggle_sweep
  sample.penguin.atlas_isa.vpu_midbank_recip_sqrt_edge_negimm:
    platform_allow: chipyard_penguin/penguin
    extra_args: ATLAS_ISA_TEST=vpu_midbank_recip_sqrt_edge_negimm
  sample.penguin.vcu118_ta.atlas_isa.vpu_midbank_recip_sqrt_edge_negimm:
    platform_allow: chipyard_penguin/penguin/vcu118_ta
    extra_args: ATLAS_ISA_TEST=vpu_midbank_recip_sqrt_edge_negimm
  sample.penguin.atlas_isa.vpu_overlap_lut_pack_reduce:
    platform_allow: chipyard_penguin/penguin
    extra_args: ATLAS_ISA_TEST=vpu_overlap_lut_pack_reduce
  sample.penguin.vcu118_ta.atlas_isa.vpu_overlap_lut_pack_reduce:
    platform_allow: chipyard_penguin/penguin/vcu118_ta
    extra_args: ATLAS_ISA_TEST=vpu_overlap_lut_pack_reduce
  sample.penguin.atlas_isa.vpu_pack:
    platform_allow: chipyard_penguin/penguin
    extra_args: ATLAS_ISA_TEST=vpu_pack
  sample.penguin.vcu118_ta.atlas_isa.vpu_pack:
    platform_allow: chipyard_penguin/penguin/vcu118_ta
    extra_args: ATLAS_ISA_TEST=vpu_pack
  sample.penguin.atlas_isa.vpu_raw_lut_class_stress:
    platform_allow: chipyard_penguin/penguin
    extra_args: ATLAS_ISA_TEST=vpu_raw_lut_class_stress
  sample.penguin.vcu118_ta.atlas_isa.vpu_raw_lut_class_stress:
    platform_allow: chipyard_penguin/penguin/vcu118_ta
    extra_args: ATLAS_ISA_TEST=vpu_raw_lut_class_stress
  sample.penguin.atlas_isa.vpu_row_reduce:
    platform_allow: chipyard_penguin/penguin
    extra_args: ATLAS_ISA_TEST=vpu_row_reduce
  sample.penguin.vcu118_ta.atlas_isa.vpu_row_reduce:
    platform_allow: chipyard_penguin/penguin/vcu118_ta
    extra_args: ATLAS_ISA_TEST=vpu_row_reduce
  sample.penguin.atlas_isa.vpu_same_src:
    platform_allow: chipyard_penguin/penguin
    extra_args: ATLAS_ISA_TEST=vpu_same_src
  sample.penguin.vcu118_ta.atlas_isa.vpu_same_src:
    platform_allow: chipyard_penguin/penguin/vcu118_ta
    extra_args: ATLAS_ISA_TEST=vpu_same_src
  sample.penguin.atlas_isa.vpu_special_class_chain_pack:
    platform_allow: chipyard_penguin/penguin
    extra_args: ATLAS_ISA_TEST=vpu_special_class_chain_pack
  sample.penguin.vcu118_ta.atlas_isa.vpu_special_class_chain_pack:
    platform_allow: chipyard_penguin/penguin/vcu118_ta
    extra_args: ATLAS_ISA_TEST=vpu_special_class_chain_pack
  sample.penguin.atlas_isa.vpu_special_math_roundtrip_classes:
    platform_allow: chipyard_penguin/penguin
    extra_args: ATLAS_ISA_TEST=vpu_special_math_roundtrip_classes
  sample.penguin.vcu118_ta.atlas_isa.vpu_special_math_roundtrip_classes:
    platform_allow: chipyard_penguin/penguin/vcu118_ta
    extra_args: ATLAS_ISA_TEST=vpu_special_math_roundtrip_classes
  sample.penguin.atlas_isa.vpu_sqcb_branch_blast:
    platform_allow: chipyard_penguin/penguin
    extra_args: ATLAS_ISA_TEST=vpu_sqcb_branch_blast
  sample.penguin.vcu118_ta.atlas_isa.vpu_sqcb_branch_blast:
    platform_allow: chipyard_penguin/penguin/vcu118_ta
    extra_args: ATLAS_ISA_TEST=vpu_sqcb_branch_blast
  sample.penguin.atlas_isa.vpu_unary_math:
    platform_allow: chipyard_penguin/penguin
    extra_args: ATLAS_ISA_TEST=vpu_unary_math
  sample.penguin.vcu118_ta.atlas_isa.vpu_unary_math:
    platform_allow: chipyard_penguin/penguin/vcu118_ta
    extra_args: ATLAS_ISA_TEST=vpu_unary_math
  sample.penguin.atlas_isa.vpu_unary_simple:
    platform_allow: chipyard_penguin/penguin
    extra_args: ATLAS_ISA_TEST=vpu_unary_simple
  sample.penguin.vcu118_ta.atlas_isa.vpu_unary_simple:
    platform_allow: chipyard_penguin/penguin/vcu118_ta
    extra_args: ATLAS_ISA_TEST=vpu_unary_simple
  sample.penguin.atlas_isa.vpu_vli:
    platform_allow: chipyard_penguin/penguin
    extra_args: ATLAS_ISA_TEST=vpu_vli
  sample.penguin.vcu118_ta.atlas_isa.vpu_vli:
    platform_allow: chipyard_penguin/penguin/vcu118_ta
    extra_args: ATLAS_ISA_TEST=vpu_vli
  sample.penguin.atlas_isa.xlu_fanout_branch_reuse:
    platform_allow: chipyard_penguin/penguin
    extra_args: ATLAS_ISA_TEST=xlu_fanout_branch_reuse
  sample.penguin.vcu118_ta.atlas_isa.xlu_fanout_branch_reuse:
    platform_allow: chipyard_penguin/penguin/vcu118_ta
    extra_args: ATLAS_ISA_TEST=xlu_fanout_branch_reuse
  sample.penguin.atlas_isa.xlu_transpose:
    platform_allow: chipyard_penguin/penguin
    extra_args: ATLAS_ISA_TEST=xlu_transpose
  sample.penguin.vcu118_ta.atlas_isa.xlu_transpose:
    platform_allow: chipyard_penguin/penguin/vcu118_ta
    extra_args: ATLAS_ISA_TEST=xlu_transpose
```
