## atlas/upstream/sample.yaml
```yaml
# SPDX-License-Identifier: Apache-2.0
# One scenario per Atlas-team host test and board variant (generated by hand from tests.cmake).
# Build-only: plain Spike has no Atlas (see atlas/kernels/sample.yaml). With the Atlas Spike model
# (SPIKE_EXTRA_ARGS, see the README) they can be run; the model has no tensor/DMA ops yet.
# run_tests.py builds only the board it is given, so the vcu118_ta scenarios SKIP on the default
# board: build them with --board chipyard_penguin/penguin/vcu118_ta.
# The tests marked `skip: true` need golden headers from the team's bit-exact models, whose Python
# generators `import torch`; no pre-generated headers exist in the source repo and our env has no
# torch. Remove `skip: true` (or build one with -DATLAS_TEST=<name>) in an environment with torch+numpy.
sample:
  name: atlas_upstream
common:
  tags: atlas hardware atlas_upstream
  build_only: true
tests:
  sample.penguin.atlas_upstream.atlas_alu_basic:
    platform_allow: chipyard_penguin/penguin
    extra_args: ATLAS_TEST=atlas_alu_basic
  sample.penguin.vcu118_ta.atlas_upstream.atlas_alu_basic:
    platform_allow: chipyard_penguin/penguin/vcu118_ta
    extra_args: ATLAS_TEST=atlas_alu_basic
  sample.penguin.atlas_upstream.saturn_atlas_vmem_smoke:
    platform_allow: chipyard_penguin/penguin
    extra_args: ATLAS_TEST=saturn_atlas_vmem_smoke
  sample.penguin.vcu118_ta.atlas_upstream.saturn_atlas_vmem_smoke:
    platform_allow: chipyard_penguin/penguin/vcu118_ta
    extra_args: ATLAS_TEST=saturn_atlas_vmem_smoke
  sample.penguin.atlas_upstream.saturn_atlas_pause_resume:
    platform_allow: chipyard_penguin/penguin
    extra_args: ATLAS_TEST=saturn_atlas_pause_resume
  sample.penguin.vcu118_ta.atlas_upstream.saturn_atlas_pause_resume:
    platform_allow: chipyard_penguin/penguin/vcu118_ta
    extra_args: ATLAS_TEST=saturn_atlas_pause_resume
  sample.penguin.atlas_upstream.saturn_atlas_pi0_slice:
    platform_allow: chipyard_penguin/penguin
    extra_args: ATLAS_TEST=saturn_atlas_pi0_slice
  sample.penguin.vcu118_ta.atlas_upstream.saturn_atlas_pi0_slice:
    platform_allow: chipyard_penguin/penguin/vcu118_ta
    extra_args: ATLAS_TEST=saturn_atlas_pi0_slice
  sample.penguin.atlas_upstream.saturn_atlas_buffered_optA_end_jal:
    platform_allow: chipyard_penguin/penguin
    extra_args: ATLAS_TEST=saturn_atlas_buffered_optA_end_jal
  sample.penguin.vcu118_ta.atlas_upstream.saturn_atlas_buffered_optA_end_jal:
    platform_allow: chipyard_penguin/penguin/vcu118_ta
    extra_args: ATLAS_TEST=saturn_atlas_buffered_optA_end_jal
  sample.penguin.atlas_upstream.saturn_atlas_buffered_lower_first:
    platform_allow: chipyard_penguin/penguin
    extra_args: ATLAS_TEST=saturn_atlas_buffered_lower_first
  sample.penguin.vcu118_ta.atlas_upstream.saturn_atlas_buffered_lower_first:
    platform_allow: chipyard_penguin/penguin/vcu118_ta
    extra_args: ATLAS_TEST=saturn_atlas_buffered_lower_first
  sample.penguin.atlas_upstream.saturn_atlas_buffered_optB_restart:
    platform_allow: chipyard_penguin/penguin
    extra_args: ATLAS_TEST=saturn_atlas_buffered_optB_restart
  sample.penguin.vcu118_ta.atlas_upstream.saturn_atlas_buffered_optB_restart:
    platform_allow: chipyard_penguin/penguin/vcu118_ta
    extra_args: ATLAS_TEST=saturn_atlas_buffered_optB_restart
  sample.penguin.atlas_upstream.saturn_atlas_vmem_3way_arb:
    platform_allow: chipyard_penguin/penguin
    extra_args: ATLAS_TEST=saturn_atlas_vmem_3way_arb
  sample.penguin.vcu118_ta.atlas_upstream.saturn_atlas_vmem_3way_arb:
    platform_allow: chipyard_penguin/penguin/vcu118_ta
    extra_args: ATLAS_TEST=saturn_atlas_vmem_3way_arb
  sample.penguin.atlas_upstream.saturn_atlas_4rung_2bank_arb:
    platform_allow: chipyard_penguin/penguin
    extra_args: ATLAS_TEST=saturn_atlas_4rung_2bank_arb
  sample.penguin.vcu118_ta.atlas_upstream.saturn_atlas_4rung_2bank_arb:
    platform_allow: chipyard_penguin/penguin/vcu118_ta
    extra_args: ATLAS_TEST=saturn_atlas_4rung_2bank_arb
  sample.penguin.atlas_upstream.saturn_atlas_vmem_dram_dual:
    platform_allow: chipyard_penguin/penguin
    extra_args: ATLAS_TEST=saturn_atlas_vmem_dram_dual
  sample.penguin.vcu118_ta.atlas_upstream.saturn_atlas_vmem_dram_dual:
    platform_allow: chipyard_penguin/penguin/vcu118_ta
    extra_args: ATLAS_TEST=saturn_atlas_vmem_dram_dual
  sample.penguin.atlas_upstream.saturn_atlas_dmem_sbus_dma:
    platform_allow: chipyard_penguin/penguin
    extra_args: ATLAS_TEST=saturn_atlas_dmem_sbus_dma
  sample.penguin.vcu118_ta.atlas_upstream.saturn_atlas_dmem_sbus_dma:
    platform_allow: chipyard_penguin/penguin/vcu118_ta
    extra_args: ATLAS_TEST=saturn_atlas_dmem_sbus_dma
  sample.penguin.atlas_upstream.saturn_atlas_8dma_rvv_vmem:
    platform_allow: chipyard_penguin/penguin
    extra_args: ATLAS_TEST=saturn_atlas_8dma_rvv_vmem
  sample.penguin.vcu118_ta.atlas_upstream.saturn_atlas_8dma_rvv_vmem:
    platform_allow: chipyard_penguin/penguin/vcu118_ta
    extra_args: ATLAS_TEST=saturn_atlas_8dma_rvv_vmem
  sample.penguin.atlas_upstream.saturn_atlas_8dma_rvv_vmem_nosaturn:
    platform_allow: chipyard_penguin/penguin
    extra_args: ATLAS_TEST=saturn_atlas_8dma_rvv_vmem_nosaturn
  sample.penguin.vcu118_ta.atlas_upstream.saturn_atlas_8dma_rvv_vmem_nosaturn:
    platform_allow: chipyard_penguin/penguin/vcu118_ta
    extra_args: ATLAS_TEST=saturn_atlas_8dma_rvv_vmem_nosaturn
  sample.penguin.atlas_upstream.saturn_atlas_smolvla_compose:
    platform_allow: chipyard_penguin/penguin
    extra_args: ATLAS_TEST=saturn_atlas_smolvla_compose
    skip: true
    tags: needs_python:torch
  sample.penguin.vcu118_ta.atlas_upstream.saturn_atlas_smolvla_compose:
    platform_allow: chipyard_penguin/penguin/vcu118_ta
    extra_args: ATLAS_TEST=saturn_atlas_smolvla_compose
    skip: true
    tags: needs_python:torch
  sample.penguin.atlas_upstream.saturn_atlas_smolvla_compose_large:
    platform_allow: chipyard_penguin/penguin
    extra_args: ATLAS_TEST=saturn_atlas_smolvla_compose_large
    skip: true
    tags: needs_python:torch
  sample.penguin.vcu118_ta.atlas_upstream.saturn_atlas_smolvla_compose_large:
    platform_allow: chipyard_penguin/penguin/vcu118_ta
    extra_args: ATLAS_TEST=saturn_atlas_smolvla_compose_large
    skip: true
    tags: needs_python:torch
  sample.penguin.atlas_upstream.saturn_atlas_tri_phase:
    platform_allow: chipyard_penguin/penguin
    extra_args: ATLAS_TEST=saturn_atlas_tri_phase
    skip: true
    tags: needs_python:torch
  sample.penguin.vcu118_ta.atlas_upstream.saturn_atlas_tri_phase:
    platform_allow: chipyard_penguin/penguin/vcu118_ta
    extra_args: ATLAS_TEST=saturn_atlas_tri_phase
    skip: true
    tags: needs_python:torch
  sample.penguin.atlas_upstream.saturn_atlas_tri_phase_large:
    platform_allow: chipyard_penguin/penguin
    extra_args: ATLAS_TEST=saturn_atlas_tri_phase_large
    skip: true
    tags: needs_python:torch
  sample.penguin.vcu118_ta.atlas_upstream.saturn_atlas_tri_phase_large:
    platform_allow: chipyard_penguin/penguin/vcu118_ta
    extra_args: ATLAS_TEST=saturn_atlas_tri_phase_large
    skip: true
    tags: needs_python:torch
  sample.penguin.atlas_upstream.saturn_atlas_fp8_quantize_bridge:
    platform_allow: chipyard_penguin/penguin
    extra_args: ATLAS_TEST=saturn_atlas_fp8_quantize_bridge
    skip: true
    tags: needs_python:torch
  sample.penguin.vcu118_ta.atlas_upstream.saturn_atlas_fp8_quantize_bridge:
    platform_allow: chipyard_penguin/penguin/vcu118_ta
    extra_args: ATLAS_TEST=saturn_atlas_fp8_quantize_bridge
    skip: true
    tags: needs_python:torch
  sample.penguin.atlas_upstream.saturn_atlas_fp8_dequant_bridge:
    platform_allow: chipyard_penguin/penguin
    extra_args: ATLAS_TEST=saturn_atlas_fp8_dequant_bridge
    skip: true
    tags: needs_python:torch
  sample.penguin.vcu118_ta.atlas_upstream.saturn_atlas_fp8_dequant_bridge:
    platform_allow: chipyard_penguin/penguin/vcu118_ta
    extra_args: ATLAS_TEST=saturn_atlas_fp8_dequant_bridge
    skip: true
    tags: needs_python:torch
  sample.penguin.atlas_upstream.saturn_atlas_quad_phase_large:
    platform_allow: chipyard_penguin/penguin
    extra_args: ATLAS_TEST=saturn_atlas_quad_phase_large
    skip: true
    tags: needs_python:torch
  sample.penguin.vcu118_ta.atlas_upstream.saturn_atlas_quad_phase_large:
    platform_allow: chipyard_penguin/penguin/vcu118_ta
    extra_args: ATLAS_TEST=saturn_atlas_quad_phase_large
    skip: true
    tags: needs_python:torch
  sample.penguin.atlas_upstream.saturn_atlas_smolvla_compose_native_bf16:
    platform_allow: chipyard_penguin/penguin
    extra_args: ATLAS_TEST=saturn_atlas_smolvla_compose_native_bf16
    skip: true
    tags: needs_python:torch
  sample.penguin.vcu118_ta.atlas_upstream.saturn_atlas_smolvla_compose_native_bf16:
    platform_allow: chipyard_penguin/penguin/vcu118_ta
    extra_args: ATLAS_TEST=saturn_atlas_smolvla_compose_native_bf16
    skip: true
    tags: needs_python:torch
  sample.penguin.atlas_upstream.saturn_atlas_tri_phase_native_bf16:
    platform_allow: chipyard_penguin/penguin
    extra_args: ATLAS_TEST=saturn_atlas_tri_phase_native_bf16
    skip: true
    tags: needs_python:torch
  sample.penguin.vcu118_ta.atlas_upstream.saturn_atlas_tri_phase_native_bf16:
    platform_allow: chipyard_penguin/penguin/vcu118_ta
    extra_args: ATLAS_TEST=saturn_atlas_tri_phase_native_bf16
    skip: true
    tags: needs_python:torch
```

## samples/atlas_kernels/Kconfig
```kconfig
# SPDX-License-Identifier: Apache-2.0

mainmenu "Atlas upstream host tests"

config ATLAS_KERNELS_TIMEOUT_MCYCLES
	int "Per-wait timeout in host mcycle ticks (millions)"
	default 400
	help
	  How long the host waits for Atlas to signal "halted" (or dbg0 != 0 in
	  alu_basic) before declaring TIMEOUT, forcing execControl=0 and moving
	  on. Measured with the HOST's mcycle, so the wall time is
	  value / core clock: 400 M = ~4 s at 100 MHz, ~8 s at 50 MHz.
	  The kernels run for at most a few million Atlas cycles.

config ATLAS_KERNELS_RACE_TESTS
	bool "Run the concurrent IMEM-write tests (optA end-JAL, lower-first)"
	default y
	help
	  Both tests overwrite IMEM while Atlas executes a ~500000-iteration
	  busy loop and depend on the host finishing ~30 MMIO accesses before
	  the loop ends. A FAIL there can be timing (slow host link) instead of
	  broken hardware; turn off to get only deterministic tests.

config ATLAS_KERNELS_VMEM_VECTOR
	bool "Run RVV (vector load/store) accesses to VMEM"
	default y
	help
	  vmem_vector and the Saturn transform step of pause_resume use vle32/
	  vse32 on the Atlas VMEM window. Turn off to isolate scalar-only access
	  if a vector access to VMEM hangs the bus.

source "Kconfig.zephyr"
```

## samples/atlas_upstream/Kconfig
```kconfig
# SPDX-License-Identifier: Apache-2.0

mainmenu "Atlas upstream host tests (built from tapeout-chipyard)"

config ATLAS_UPSTREAM_TIMEOUT_S
	int "Watchdog: seconds of wall time before the test is declared hung"
	default 120
	help
	  Upstream polls the Atlas status register up to 200 million times and
	  then reports a failure; on a slow link that is minutes, and some
	  tests have no timeout at all. The shim runs the test's main() in the
	  main thread and a watchdog thread that, after this many seconds,
	  writes execControl=0 (stops Atlas), prints "ATLASUP <test> TIMEOUT"
	  and ends the run with exit code 124.

	  Cannot help if a bus access itself never returns (the whole core is
	  stuck); then the last line printed before the hang names the stage.

source "Kconfig.zephyr"
```

## tests/rvv/ctx_switch_min/testcase.yaml
```yaml
# SPDX-License-Identifier: Apache-2.0
common:
  filter: CONFIG_RISCV_ISA_EXT_V
  harness: ztest
  integration_platforms:
    - chipyard_penguin/penguin
tests:
  arch.riscv.rvv.ctx_switch_min:
    tags: rvv
```
